AUTOSAR XML (schema 00046)
package /AUTOSAR/EcucDefs
  module definition ComM [0..1]: post-build-variant-support=true, variants post-build/pre-compile  # Configuration of the ComM (Communications Manager) module. / 概述：ComM（Communication Manager）模块负责管理ECU中的通信网络接口的状态，确保根据车辆的不同操作模式调整网络接口的行为。 注意：ComM配置必须与ECU支持的网络接口和通信协议一致；确保与Nm（网络管理）、EcuM（ECU管理）等其他管理模块的正确交互；在配置时应考虑系统的功耗和唤醒策略。
    container ComMConfigSet  # This container contains the configuration parameters and sub containers of the AUTOSAR ComM module. / 概述：ComMConfigSet 是一个配置容器，包含了用于通信管理（ComM）模块的参数集合，这些参数定义了网络管理策略、通信模式和用户请求处理。 注意：在配置ComMConfigSet时，必须确保所有的网络通道（Channels）和用户（Users）都被正确配置；每个ComMChannel需要至少一个ComMUser；配置参数应符合ECU的网络管理需求和硬件能力。
      boolean ComMPncEnabled [0..1]: scope=ECU, multiplicity set at post-build in variant post-build / pre-compile in variant pre-compile, post-build-variant-multiplicity=true, post-build-variant-value=true, set at post-build in variant post-build / pre-compile in variant pre-compile, default-value=false  # Defines whether in this configuration set the partial networking is enabled. / 概述：ComMPncEnabled是一个配置项，用于启用或禁用部分网络集群（Partial Network Cluster）的功能，这是通信堆栈中的一个特性，用于控制ECU的网络管理行为。 注意：在AUTOSAR CP 4.4标准中，确保在使用此配置项时，ECU的网络管理需求与部分网络集群功能相匹配；如果ECU不支持部分网络集群功能，则不应启用此配置项；在配置时，应考虑与其他网络管理配置项的兼容性和一致性。 | true: Enabled false: Disabled
      container ComMChannel [1..256]  # This container contains the configuration (parameters) of the bus channel(s). The channel parameters shall be harmonized within the whole communication stack. / 概述：ComMChannel是指通信管理模块中的通信通道，用于管理ECU内部或与其他ECU之间的网络通信状态，确保网络通信的可靠性和高效性。 注意：在配置ComMChannel时，需要确保其与ECU支持的网络接口类型相匹配；每个ComMChannel应唯一对应一个物理或虚拟的网络通道；在AUTOSAR CP 4.4中，对ComMChannel的配置参数和行为有详细规定，需要遵循这些规定以保证兼容性和性能。
        boolean ComMFullCommRequestNotificationEnabled: set at pre-compile, default-value=false  # Defines if the optional SenderReceiver Port of Interface ComM_CurrentChannelRequest will be provided for this channel. / 概述：ComMFullCommRequestNotificationEnabled 是一个布尔配置项，用于启用或禁用通信管理器（ComM）模块中全通信模式请求的通知功能。 注意：在AUTOSAR CP 4.4标准中，确保此配置项与系统设计需求一致，如果系统需要在请求全通信模式时接收通知，则应启用此功能；此配置项的默认值通常取决于具体的通信需求和ECU资源限制；在配置此项时，应考虑与其他BswM或ECUM的交互，以确保通信状态管理的正确性。 | True means enabled. False means disabled
        boolean ComMNoCom: set at pre-compile, default-value=false  # Not allowed to change state of ComM channel to COMM_SILENT_COMMUNICATION or COMM_FULL_COMMUNICATION. / 概述：ComMNoCom 是一个配置参数，用于定义通信管理模块（ComM）在无通信模式（No Communication Mode）下的行为，控制网络接口的通信能力。 注意：确保正确配置以避免网络节点在不应该通信的时候进行数据传输；此模式通常用于降低能耗或满足特定的系统安全需求；在实施时需考虑与其他通信管理模式的协调和切换逻辑。 | true: Enabled - Not allowed to switch to Communication Modes above. false: Disabled - Allowed to switch Communication Modes above. Shall be possible to change parameter during runtime with ComM API's. ECU/All channels: ComM_LimitECUToNoComMode(). Separate channels: ComM_LimitChannelToNoComMode().
        boolean ComMNoWakeup: set at pre-compile, default-value=false  # Defines if an ECU is not allowed to wake-up the channel. / 概述：ComMNoWakeup用于指定通信管理模块（ComM）在没有唤醒事件发生时的行为，主要用于控制网络管理逻辑以减少能耗。 注意：在配置ComMNoWakeup时，需要确保与ECU的低功耗需求相匹配；此配置项对于实现车辆的休眠模式和唤醒策略至关重要；不正确的配置可能导致网络无法按预期进入低功耗状态或唤醒。 | true: Enabled (not allowed to wake-up)) false: Disabled This is the default/init value of a runtime variable that can be changed during runtime using ComM_PreventWakeUp().
        boolean ComMNoWakeUpInhibitionNvmStorage: set at pre-compile  # If this parameter is set to "true", the NoWakeUp inhibition state of the channel shall be stored (in some implementation specific way) in the block pointed to by ComMGlobalNvmBlockDescriptor. / 概述：ComMNoWakeUpInhibitionNvmStorage 用于配置是否将通信管理器（ComM）的无唤醒抑制状态存储在非易失性存储器（NVM）中。 注意：在AUTOSAR CP 4.4中，此配置项确保在系统重启后，无唤醒抑制状态能够被恢复，从而维持网络管理的连续性；正确配置此项可以避免车辆在某些情况下无法唤醒的问题；应根据项目具体需求决定是否启用此功能。
        enumeration ComMBusType: {COMM_BUS_TYPE_CAN, COMM_BUS_TYPE_CDD, COMM_BUS_TYPE_ETH, COMM_BUS_TYPE_FR, COMM_BUS_TYPE_INTERNAL, COMM_BUS_TYPE_LIN}, scope=ECU, set at pre-compile, default-value=COMM_BUS_TYPE_CAN  # Identifies the bus type of the channel. / 概述：ComMBusType配置项用于定义通信管理模块（ComM）所管理的网络类型，例如CAN、LIN或者Ethernet，以确保正确的网络管理策略被应用。 注意：在配置ComMBusType时，必须确保所选网络类型与实际项目中使用的网络类型一致；不同的网络类型可能需要不同的配置参数和管理策略；AUTOSAR CP 4.4标准支持多种网络类型，但具体实现细节可能因供应商而异。
        enumeration ComMPncGatewayType [0..1]: {COMM_GATEWAY_TYPE_ACTIVE, COMM_GATEWAY_TYPE_PASSIVE}, scope=ECU, multiplicity set at pre-compile, set at pre-compile, default-value=COMM_GATEWAY_TYPE_ACTIVE  # Identifies the Partial Network Gateway behaviour of a ComMChannel. / 概述：ComMPncGatewayType 配置项定义了部分网络（Partial Network）通信网关的类型，用于控制和管理部分网络请求和释放，以优化网络的能耗。 注意：在配置ComMPncGatewayType时，需要确保它与系统中实际使用的部分网络类型相匹配；此配置项对于实现网络管理策略至关重要，因此需要仔细规划和验证；在AUTOSAR CP 4.4标准中，应当参照相关的通信管理模块来配置此项，以确保兼容性和正确性。
        float ComMMainFunctionPeriod: 0..Inf, scope=ECU, set at pre-compile, default-value=0.01  # Specifies the period in seconds that the MainFunction has to be triggered with. / 概述：ComMMainFunctionPeriod配置项定义了通信管理主函数(ComM_MainFunction)的调用周期，单位为毫秒。这个周期决定了通信管理模块检查网络管理需求和状态变化的频率。 注意：该值需要根据ECU的实际需求和网络管理策略来配置，以确保系统的响应性和效率；过小的周期可能会增加系统的负载，而过大的周期可能导致网络状态反应不够及时；在配置时需要考虑与其他BswM模块的周期性调用的协调。 | Comment: ComM scheduling shall be at least as fast as the communication stack and a schedule longer than 100ms makes no sense for communication.
        integer ComMChannelId: 0..255, scope=ECU, set at pre-compile, symbolic-name-value=true  # Channel identification number of the corresponding channel. / 概述：ComMChannelId 是一个配置项，用于唯一标识通信管理模块（ComM）中的通信通道，它关联了网络层的通道与ComM模块。 注意：ComMChannelId 必须是唯一的，以确保每个通信通道都能被正确识别和管理；在配置时应确保其与网络层的通道配置相匹配；在整个系统中，应避免ComMChannelId的重复配置，以防止通信冲突。
        string ComMCDDBusPrefix [0..1]: multiplicity set at pre-compile, set at pre-compile  # Prefix to be used for API calls to CDD. / 概述：ComMCDDBusPrefix 是一个配置参数，用于定义通信管理模块（ComM）中，与CAN数据总线相关的标识符前缀，以便在生成代码时区分不同的网络通道。 注意：在配置时需保证前缀的唯一性，以避免在多网络环境中的命名冲突；前缀应简短且具有描述性，以便于理解和维护；在AUTOSAR CP 4.4标准中，确保该配置项符合命名规范和项目实际需求。
        reference ComMManageReference [0..1]: multiplicity set at pre-compile, set at pre-compile, destination=ComMChannel  # Represenst the reference between a ComMChannel with role managing channel and a ComMChannel with role managed channel. / 概述：ComMManageReference配置项用于定义通信管理模块（ComM）中网络请求和释放的参考管理，确保网络通信资源的有效管理和调度。 注意：该配置项需要与ECU的网络管理策略紧密配合，以避免资源冲突；在配置时需确保参考的网络请求和释放策略与实际的网络管理需求一致；AUTOSAR CP 4.4标准中对于网络管理的具体实现细节有严格规定，需仔细遵守以保证兼容性。
        container ComMNetworkManagement  # This container contains the configuration parameters of the networkmanagement. / 概述：ComMNetworkManagement 是一个配置项，用于定义通信管理模块（ComM）如何与网络管理（Nm）接口交互，以控制网络节点的状态和通信。 注意：在配置ComMNetworkManagement时，需要确保它与所使用的网络管理协议（如 CAN NM, FR NM, LIN NM 等）兼容；此外，应当注意配置正确的网络通道标识符，以确保网络管理正确地控制对应的网络节点；在AUTOSAR CP 4.4标准中，应当遵循相关的模块间接口定义和行为规范。
          boolean ComMPncNmRequest: set at pre-compile, default-value=false  # If this parameter equals true then every time a FULL Communication is requested due to a change in the PNC state machine to COMM_PNC_REQUESTED Nm shall be called using the API Nm_NetworkRequest. / 概述：ComMPncNmRequest 配置项用于定义网络管理请求的处理方式，确保车辆网络在需要时能够快速地进行状态转换。 注意：在配置ComMPncNmRequest时，必须确保与车辆的网络管理策略一致；此配置项应与其他网络管理配置项协同工作，以避免配置冲突；AUTOSAR CP 4.4中对此配置项的具体参数和行为有详细规定，需要仔细遵守标准。
          enumeration ComMNmVariant: {FULL, LIGHT, LINSLAVE, NONE, PASSIVE}, set at pre-compile, default-value=FULL  # Defines the functionality of the networkmanagement. / 概述：ComMNmVariant配置项用于定义网络管理（Nm）的变体，指定了车辆网络管理策略的类型，如是否使用CAN网络管理、GATEWAY网络管理等。 注意：在选择ComMNmVariant时，需确保其与项目中实际使用的网络管理策略相匹配；若项目中使用了多种网络管理策略，需要为每种策略正确配置对应的变体；AUTOSAR CP 4.4标准中对网络管理的配置和实现有详细规定，需仔细遵守以保证系统的兼容性和稳定性。 | Shall be harmonized with NM configuration.
          float ComMNmLightTimeout [0..1]: 0..255, multiplicity set at pre-compile, set at pre-compile, default-value=10  # Defines the timeout (in seconds) after COMM_FULL_COMMUNICATION sub-state COMM_FULL_COM_READY_SLEEP is left. / 概述：ComMNmLightTimeout配置项用于定义网络管理轻量级模式下，节点等待网络管理消息的超时时间，以确保网络稳定性和节点同步。 注意：该配置项的值需根据网络的实际情况和性能要求谨慎设置，以避免因超时设置不当导致的网络通信问题；在AUTOSAR CP 4.4标准中，确保该配置项与网络管理策略和其他相关配置项协同工作；超时时间设置过短可能导致频繁的网络管理状态切换，设置过长可能影响网络的响应速度。 | The range shall be greater than 0.0 and less or equal to 255.0.
        container ComMUserPerChannel [0..255]  # This container contains a list of identifiers that are needed to refer to a user in the system which is linked to a channel. / 概述：ComMUserPerChannel 配置项定义了通信管理器（ComM）中用户和网络通道之间的关系，用于指定哪些用户需要哪些通道来进行通信。 注意：在配置时需要确保每个用户至少映射到一个通道；用户和通道之间的映射关系应当遵循实际的通信需求和硬件架构；在多通道系统中，正确的用户到通道的映射对于网络管理和优化资源使用至关重要。
          reference ComMUserChannel: set at pre-compile, destination=ComMUser  # Reference to the ComMUser that corresponds to this channel user. / 概述：ComMUserChannel配置项用于定义用户和网络通道之间的关系，确保通信管理模块（ComM）能够根据用户的请求管理网络通道的状态。 注意：在配置ComMUserChannel时，必须确保每个用户至少映射到一个网络通道；用户和网络通道之间的关系应当符合实际的通信需求；在配置过程中应遵循AUTOSAR CP 4.4标准中对于用户和通道关系的规定，以确保配置的有效性和一致性。 | ImplementationType: COMM_UserHandleType
      container ComMPnc [0..56]  # This container contains the configuration of the partial network cluster (PNC). / 概述：ComMPnc 配置项用于管理部分网络通信（Partial Network Communication）的设置，包括PNC的激活和去激活策略。 注意：在配置ComMPnc时，必须确保与车辆网络的其他部分兼容，特别是与ECU的网络管理功能；PNC设置应遵循AUTOSAR CP 4.4标准中定义的网络管理策略；正确配置PNC可以帮助降低网络的能耗，提高效率。
        integer ComMPncId: 8..63, scope=ECU, set at pre-compile, symbolic-name-value=true  # Partial network cluster identification number. / 概述：ComMPncId是用于标识PDU（协议数据单元）中特定的部分网络通信（Partial Network Communication）的ID，它允许在AUTOSAR COM层中配置和管理基于部分网络的通信需求。 注意：PncId的值必须在系统中唯一，以避免配置冲突；在设计时需确保PncId与系统中其他网络管理元素的标识符相协调；AUTOSAR CP 4.4标准中对PncId的具体数值范围有明确规定，需遵守这些规定以保证兼容性。
        reference ComMChannelPerPnc [1..256]: multiplicity set at post-build in variant post-build / pre-compile in variant pre-compile, post-build-variant-multiplicity=true, post-build-variant-value=true, set at post-build in variant post-build / pre-compile in variant pre-compile, destination=ComMChannel  # Reference to the ComMChannel that is required for this PNC. / 概述：ComMChannelPerPnc配置项用于定义网络管理中，每个部分网络（PNC, Partial Network Cluster）与通信通道（ComMChannel）之间的关系，确保正确的网络请求和释放策略被应用。 注意：在配置时需确保每个PNC至少关联一个ComMChannel，以保证网络请求能够正确传递；不同PNC可以共享同一个ComMChannel，但需注意资源竞争和通信冲突；该配置项在AUTOSAR CP 4.4中是一致的，但设计时应考虑网络管理策略的复杂性和系统资源限制。 | ImplementationType: NetworkHandleType
        reference ComMPncEthIfSwitchPortGroupRef [0..255]: scope=ECU, multiplicity set at link in variant post-build / pre-compile in variant pre-compile, post-build-variant-multiplicity=true, post-build-variant-value=true, set at link in variant post-build / pre-compile in variant pre-compile, requires-symbolic-name-value=true, destination=EthIfSwitchPortGroup  # Reference to the PortGroups that correspond to this PNC. Note: This is only for documentation. / 概述：ComMPncEthIfSwitchPortGroupRef 是一个配置项，用于将PNC（Partial Network Cluster）与特定的以太网交换机端口组相关联，以便管理PNC的网络请求和释放。 注意：在配置ComMPncEthIfSwitchPortGroupRef时，必须确保引用的以太网交换机端口组已经在系统中定义并且与PNC的通信需求相匹配；此配置项对于实现PNC的网络管理功能至关重要，因此需要仔细检查其正确性；AUTOSAR CP 4.4标准中，确保该配置项与其他网络管理配置项协同工作，以保证网络管理的一致性和有效性。
        reference ComMUserPerPnc [0..255]: multiplicity set at post-build in variant post-build / pre-compile in variant pre-compile, post-build-variant-multiplicity=true, post-build-variant-value=true, set at post-build in variant post-build / pre-compile in variant pre-compile, destination=ComMUser  # Reference to the ComMUsers that correspond to this PNC. / 概述：ComMUserPerPnc 配置项定义了通信管理器（ComM）中，每个部分网络（PNC）对应的用户需求，用于管理网络请求和释放。 注意：在配置时需确保每个PNC与至少一个用户正确关联；用户和PNC之间的关系应符合实际的网络管理需求；在AUTOSAR CP 4.4标准中，应遵循PNC和用户之间的关联规则，以确保网络管理的正确性。 | ImplementationType: COMM_UserHandleType
        container ComMPncComSignal [0..*]  # Represents the PncComSignals which are used to communicate the EIRA and ERA status of this PNC. / 概述：ComMPncComSignal配置项用于定义参与部分网络通信（Partial Network Communication）的信号，这些信号用于控制和监视部分网络的状态。 注意：在配置ComMPncComSignal时，确保信号与部分网络的需求相匹配；此配置项在AUTOSAR CP 4.4中可能不直接存在，因为部分网络管理通常由ComM模块处理，需要检查与ComM模块的兼容性；正确配置信号属性，如信号长度和更新周期，以满足部分网络通信的实时性要求。
          enumeration ComMPncComSignalDirection: {RX, TX}, set at pre-compile, default-value=RX  # Indicates the communication direction of this PncComSignal. / 概述：ComMPncComSignalDirection 配置项用于定义部分网络通信（Partial Network Communication）中信号的传输方向，即信号是发送还是接收。 注意：在配置ComMPncComSignalDirection时，需要确保信号方向与实际的系统设计和网络通信需求相匹配；AUTOSAR CP 4.4标准中对于部分网络通信的支持可能有特定的限制或要求，需要参考相关文档以确保一致性；在多信号系统中，正确配置每个信号的方向对于系统的正确运行至关重要。
          enumeration ComMPncComSignalKind [0..1]: {EIRA, ERA}, multiplicity set at pre-compile, set at pre-compile, default-value=EIRA  # Indicates whether this PncComSignal represents EIRA or ERA PNC information. / 概述：ComMPncComSignalKind 配置项用于定义车辆网络中通信信号的类型，这有助于优化网络通信策略和资源管理。 注意：确保每个信号类型正确匹配其功能和网络要求；不正确的配置可能导致通信效率低下或数据传输错误；在配置时需遵循AUTOSAR CP 4.4标准中对信号类型的具体定义和要求。 | This parameter ComMPncComSignalKind is optional and shall be ignored when ComMPncComSignalDirection equals TX.
          reference ComMPncComSignalChannelRef [0..1]: multiplicity set at pre-compile, set at pre-compile, destination=ComMChannel  # Reference to the ComMChannel which is used to determine whether this PncComSignal shall participate in the active or passive role (via the parameter ComMPncGatewayType of the ComMChannel). / 概述：ComMPncComSignalChannelRef 是一个配置参数，用于将部分网络请求信号（PNC信号）映射到通信信道上，以便控制网络请求消息的发送。 注意：在配置时需确保信号与通信信道之间的映射正确无误；此配置项对于实现部分网络请求的功能至关重要；在AUTOSAR CP 4.4标准中，应遵循相关的通信管理规范来配置此参数。
          reference ComMPncComSignalRef: scope=ECU, set at pre-compile, requires-symbolic-name-value=true, destination=ComSignal  # Reference to the ComSignal which is used to transport the partial network channel request information. / 概述：ComMPncComSignalRef 用于定义与部分网络集群（Partial Network Cluster）相关的通信信号引用，以便在车辆网络中管理睡眠和唤醒信号。 注意：确保引用的信号与实际的部分网络集群配置相匹配；在配置时需考虑信号的传输和接收特性，以保证网络的稳定性和响应速度；此配置项应与车辆的网络管理策略紧密结合，以优化能耗和通信效率。
      container ComMUser [0..255]  # This container contains a list of identifiers that are needed to refer to a user in the system which is designated to request Communication modes. / 概述：ComMUser配置项定义了通信管理模块（ComM）中用户的属性和行为，它指定了用户请求通信模式的能力和方式，以及用户与通信通道（ComMChannel）之间的关联。 注意：确保每个ComMUser正确映射到至少一个ComMChannel，以保证通信需求得到满足；用户请求的通信模式应与系统的能力和策略相匹配；在配置ComMUser时，应考虑系统的功耗和网络带宽需求。
        integer ComMUserIdentifier: 0..254, set at pre-compile, symbolic-name-value=true  # An identifier that is needed to refer to a user in the system which is designated to request Communication Modes. / 概述：ComMUserIdentifier 是一个用于唯一标识通信管理器（ComM）用户的配置项，它将用户实体与其请求的通信服务关联起来。 注意：在配置过程中，每个ComM用户必须分配一个唯一的标识符；这个标识符通常由系统设计者或配置工具分配，以确保系统中的一致性；在整个项目中，应保持ComMUserIdentifier的一致性，避免在不同的上下文中重复使用相同的标识符。 | ImplementationType: ComM_UserHandleType
        reference ComMUserEcucPartitionRef [0..1]: scope=ECU, multiplicity set at pre-compile, set at pre-compile, destination=EcucPartition  # Denotes in which "EcucPartition" the requester is executed. When the partition is stopped, the communication request shall be cancelled in the ComM / 概述：ComMUserEcucPartitionRef配置项用于指定通信管理模块（ComM）用户所属的ECU配置分区引用，确保系统中的通信请求能够被正确管理和分配到相应的分区。 注意：在多核或多分区系统中使用时，正确配置此项对于确保通信管理的隔离性和安全性至关重要；该配置项必须与系统分区设计一致，避免跨分区通信管理错误；AUTOSAR CP 4.4标准中对于分区的管理和配置有详细规定，需要确保与标准一致。 | to avoid a stay-awake situation of the bus due to a stopped partition.
    container ComMGeneral  # General configuration parameters of the Communication Manager. / 概述：ComMGeneral是AUTOSAR通信管理模块的一般配置容器，包含了影响整个通信管理模块行为的全局配置参数。 注意：在配置ComMGeneral时，需要确保参数设置与系统的通信需求相匹配；某些参数可能会影响到网络管理策略和ECU的唤醒行为；AUTOSAR CP 4.4标准中，确保使用正确的数据类型和取值范围以避免配置错误。
      boolean ComM0PncVectorAvoidance [0..1]: set at pre-compile, default-value=false  # This parameter avoids sending of 0-PNC-Vectors in case ComMPncGatewayEnabled is enabled. / 概述：ComM0PncVectorAvoidance 是一个配置项，用于指定是否启用部分网络请求（PNC）的向量避免机制，以减少网络请求的总线负载。 注意：在AUTOSAR CP 4.4标准中，确保此配置项与网络管理需求相匹配；如果启用，需要仔细配置以避免不必要的网络唤醒；此配置项的使用可能会受到具体项目或硬件平台的限制。
      boolean ComMDevErrorDetect: set at pre-compile, default-value=false  # Switches the development error detection and notification on or off. / 概述：ComMDevErrorDetect是一个配置参数，用于启用或禁用通信管理模块（ComM）的开发错误检测功能，以便在软件开发阶段识别和报告潜在的错误。 注意：在生产代码中通常禁用此功能以优化性能；确保在开发和测试阶段启用以捕获和修正错误；与AUTOSAR标准一致，但需注意资源消耗和性能影响。 | * true: detection and notification is enabled. * false: detection and notification is disabled.
      boolean ComMDirectUserMapping [0..1]: multiplicity set at pre-compile, set at pre-compile, default-value=false  # If this parameter is set to true the configuration tool shall automatically create a ComMUser per ComMPnc and a ComMUser per ComMChannel. / 概述：ComMDirectUserMapping 用于定义用户与通信管理模块之间的直接映射关系，确保正确的用户能够访问特定的通信服务。 注意：在配置ComMDirectUserMapping时，必须确保用户与服务之间的映射关系符合系统的安全和权限要求；该映射应遵循AUTOSAR CP 4.4的标准，以保证兼容性和系统的稳定性；配置错误可能导致通信服务的访问权限问题或数据安全风险。 | The shortName of the generated ComMUsers shall follow the following naming convention: PNCUser_ComMPncId, e.g. PNCUser_13 ChannelUser_ComMChannelId, e.g. ChannelUser_25 Restriction: ComMUser, which are created due to this configuration parameter, shall not be used by SWCs (only available for BswM).
      boolean ComMModeLimitationEnabled: set at pre-compile, default-value=false  # true if mode limitation functionality shall be enabled. / 概述：ComMModeLimitationEnabled 是一个配置参数，用于启用或禁用通信管理模块（ComM）的模式限制功能，该功能允许限制ECU进入某些通信模式。 注意：在配置此参数时，确保理解其对系统行为的影响；不正确的配置可能导致网络管理异常；此参数在AUTOSAR CP 4.4中是可选的，根据项目需求决定是否启用。 | true: Enabled false: Disabled
      boolean ComMPncGatewayEnabled [0..1]: multiplicity set at pre-compile, set at pre-compile, default-value=false  # Enables or disables support of Partial Network Gateway. / 概述：ComMPncGatewayEnabled配置项用于启用或禁用部分网络通信（PNC）网关功能，这是控制ECU间通信的重要机制，特别是在AUTOSAR的通信管理模块中。 注意：在AUTOSAR CP 4.4标准中，确保在使用此配置项时已经定义了网络通信需���和PNC的配置；此配置项对于实现网络分段和优化网络带宽非常关键；不正确的配置可能导致网络通信故障或性能下降。 | False: Partial Networking Gateway is disabled True: Partial Networking Gateway is enabled
      boolean ComMPncSupport: set at pre-compile, default-value=false  # Enables or disables support of partial networking. / 概述：ComMPncSupport 配置项用于指定是否启用部分网络集群（Partial Network Cluster）支持，这是一个用于优化网络管理策略的功能，允许部分网络节点处于低功耗模式以节省能源。 注意：在使用ComMPncSupport时，需要确保网络管理需求与AUTOSAR CP 4.4标准中定义的部分网络功能兼容；此外，相关的BswM配置也需要正确设置以支持PNC功能；最后，确保硬件和底层通信堆栈支持PNC特性。 | False: Partial Networking is disabled True: Partial Networking is enabled
      boolean ComMResetAfterForcingNoComm: set at pre-compile, default-value=false  # ComM shall perform a reset after entering "No Communication" mode because of an active mode limitation to "No Communication" mode. / 概述：ComMResetAfterForcingNoComm是一个配置项，用于指定通信管理模块（ComM）在强制进入No Communication状态后是否应该在下一个主周期自动重置状态。 注意：在AUTOSAR CP 4.4标准中，需要确保此配置项与系统的通信需求相一致；如果系统需要在某些情况下保持No Communication状态，不应启用自动重置；此配置项的使用应结合诊断和网络管理需求仔细考虑。 | true: Enabled false: Disabled
      boolean ComMSynchronousWakeUp: set at pre-compile, default-value=true  # Wake up of one channel shall lead to a wake up of all channels if true. / 概述：ComMSynchronousWakeUp 配置项用于定义通信管理模块是否应在网络唤醒信号到达时立即唤醒ECU。 注意：在AUTOSAR CP 4.4标准中，此配置项确保了网络管理的及时响应性和系统的低延迟；配置时需考虑ECU的功耗和唤醒策略；不适当的配置可能导致ECU响应延迟或过度消耗电源。 | true: Enabled false: Disabled
      boolean ComMVersionInfoApi: set at pre-compile, default-value=false  # Switches the possibility to read the published information with the service ComM_GetPublishedInformation(). / 概述：ComMVersionInfoApi 用于启用或禁用通信管理模块的版本信息API，允许用户获取模块的版本信息。 注意：在AUTOSAR CP 4.4中，通常建议启用此API以支持标准化的诊断和监控需求；确保在配置时正确设置此API以避免软件兼容性问题；在生产环境中，应仔细考虑是否公开版本信息，以防止潜在的安全风险。 | true: Enabled false: Disabled
      boolean ComMWakeupInhibitionEnabled: set at pre-compile, default-value=false  # true if wake up inhibition functionality enabled. / 概述：ComMWakeupInhibitionEnabled 是一个配置参数，用于启用或禁用通信管理器（ComM）中的唤醒抑制功能，该功能允许系统在特定条件下抑制唤醒信号，以减少不必要的网络活动和功耗。 注意：在配置此参数时，需要确保它与系统的功耗和唤醒策略相匹配；如果启用唤醒抑制，必须仔细定义抑制条件以避免影响系统的响应性；在AUTOSAR CP 4.4标准中，确保使用正确的模块和接口来配置和管理唤醒抑制功能。 | true: Enabled false: Disabled
      float ComMPncPrepareSleepTimer [0..1]: 0..63, multiplicity set at pre-compile, set at pre-compile  # Time in seconds the PNC state machine shall wait in COMM_PNC_PREPARE_SLEEP. / 概述：ComMPncPrepareSleepTimer配置项用于定义在部分网络控制器（PNC）进入准备睡眠状态之前需要等待的时间，以确保网络上的所有节点都有足够的时间来完成数据交换。 注意：该配置项的值应根据网络的实际需求和性能来设置，以避免不必要的延迟或数据丢失；在设置时需考虑网络的拓扑结构和通信协议的特性；在AUTOSAR CP 4.4标准中，该配置项的单位通常是毫秒，确保与系统的时间管理策略一致。
      float ComMTMinFullComModeDuration: 0.001..65, set at pre-compile, default-value=5  # Minimum time duration in seconds, spent in the COMM_FULL_COMMUNICATION sub-state COMM_FULL_COM_NETWORK_REQUESTED. / 概述：ComMTMinFullComModeDuration 是一个配置参数，用于定义ECU在全通信模式（Full Communication Mode）下必须保持的最小时间，以确保网络上的其他节点有足够的时间来识别ECU的存在。 注意：该参数的设置需要考虑网络的总体性能和其他节点的需求；设置过短可能导致网络管理问题，设置过长可能影响系统的响应时间；在AUTOSAR CP 4.4标准中，该配置应与网络管理需求和ECU的唤醒/睡眠行为相协调。
      integer ComMEcuGroupClassification: 0..255, set at pre-compile, default-value=3  # Defines whether a mode inhibition affects the ECU or not. / 概述：ComMEcuGroupClassification 配置项用于定义ECU组的分类，这有助于管理ECU间的通信和确保网络上不同ECU组之间的数据交换满足特定的分类要求。 注意：在配置ComMEcuGroupClassification时，需要确保ECU组分类与系统设计和网络管理策略一致；分类应当反映出ECU之间的通信关系和数据交换的安全级别；在AUTOSAR CP 4.4标准中，应当遵循预定义的分类枚举值，不应随意定义新的分类。 | Examples: 000: No mode inhibition can be activated 001: Wake up inhibition can be enabled
      reference ComMGlobalNvMBlockDescriptor [0..1]: scope=ECU, multiplicity set at pre-compile, set at pre-compile, requires-symbolic-name-value=true, destination=NvMBlockDescriptor  # Reference to NVRAM block containing the none volatile data. If this parameter is not configured it means that no NVRam is used at all. / 概述：ComMGlobalNvMBlockDescriptor是用于描述通信管理模块（ComM）与非易失性内存管理模块（NvM）之间数据块的关联信息，它指定了用于存储ComM相关数据的NvM块。 注意：在配置时需确保指定的NvM块ID与实际NvM配置中的块ID一致；该配置项对于实现ComM模块的NvM数据持久化至关重要；在多个ComM通道共享同一NvM块时，需要特别注意数据的读写冲突和同步问题。
package /AUTOSAR/EcucDestinationUriDefSets
  ecuc destination uri def set RteRipsUriDefSet
    ecuc destination uri def RteRipsInvocationHandler
      destination-uri-policy destination-uri-nesting-contract=TARGET-CONTAINER:
        container RteRipsInvocationHandlerFnc [0..*]  # This container describes an invocation handler function implemented by an RTE Implementation Plug-In to handle the invocation of server runnables and triggered runnables via a transformer. Tags: atp.Status=draft / 概述：RteRipsInvocationHandlerFnc是一个配置项，用于指定RTE（Runtime Environment）中的RIPS（RTE Invocation Proxy Service）调用处理函数，该函数负责代理客户端请求到服务器端的函数调用。 注意：在配置RteRipsInvocationHandlerFnc时，需要确保指定的函数符合AUTOSAR标准中对于调用处理函数的要求；此外，该函数通常由RTE生成，因此在手动配置时应谨慎以避免与自动生成的代码冲突；最后，确保该处理函数能够正确地处理跨软件组件的调用，包括参数的封装和解封装。
          function name RteRipsInvocationHandlerFncSymbol  # C-Symbol of the Rte_Rips_FillFlushRoutine function. Tags: atp.Status=draft / 概述：RteRipsInvocationHandlerFncSymbol 是用于定义RTE生成代码中，RIPS（Receiver Indicator Proxy Status）回调函数的符号名称，该函数用于处理接收到的指示器或代理状态变化。 注意：在配置时需确保符号名称的唯一性，避免与系统中其他函数或变量的名称冲突；符号名称应符合编程语言和AUTOSAR命名规范；在多个软件组件共享同一指示器或代理时，应确保正确的回调函数被关联。
    ecuc destination uri def RteRipsPlugin
      destination-uri-policy destination-uri-nesting-contract=TARGET-CONTAINER:
        container RteRipsPluginProps  # This container defines the identity of the Rte Implementation Plug-in and provides the RTE relevant parameters of the Rte Implementation Plug-in. Tags: atp.Status=draft / 概述：RteRipsPluginProps 是一个配置项，用于定义RTE生成代码时所使用的插件属性，这些属性可以影响代码生成的各个方面，如优化级别、代码风格等。 注意：在配置RteRipsPluginProps时，需要确保所选插件属性与项目要求相符，同时与AUTOSAR CP 4.4标准保持一致；不当的配置可能会导致代码生成不符合预期，影响系统性能和功能；在多供应商环境中，还需考虑插件的兼容性问题，确保不同供应商的工具链能够无缝协作。 | The shortName of the container defines the name of the Rte Implementation Plug-in used for the API infixes.
          boolean RtePluginSupportsIReadIWrite: default-value=false  # Denotes if or if not the plug-in supports the Rte_Rips_IRead/IWrite macros for primitive data. Tags: atp.Status=draft / 概述：RtePluginSupportsIReadIWrite配置项用于指定RTE生成代码时是否支持IRead和IWrite接口，这些接口用于简化组件间的数据读写操作。 注意：在AUTOSAR CP 4.4标准中，对于IRead和IWrite的支持是可选的，因此开发者需要根据项目需求决定是否启用此功能；启用IRead和IWrite可能会影响生成代码的大小和性能；确保在项目早期决定此配置以避免后期大规模更改。
          enumeration RteRipsGlobalCopyInstantiationPolicy: {RTE_RIPS_INSTANTIATION_BY_PLUGIN, RTE_RIPS_INSTANTIATION_BY_RTE}, default-value=RTE_RIPS_INSTANTIATION_BY_RTE  # Globally enables or disables the support for Rte Implementation Plug-Ins (RIPS) Tags: atp.Status=draft / 概述：RteRipsGlobalCopyInstantiationPolicy 配置项定义了RTE（Runtime Environment）中的全局数据元素（Inter-Partition Communication, IPC）的实例化策略，用于控制如何在不同分区间共享和访问数据。 注意：在AUTOSAR CP 4.4标准中，需要确保该配置项与系统设计的分区安全策略一致；正确配置此项对于系统的数据一致性和安全性至关重要；在多分区系统中，应特别注意数据共享策略对系统性能的影响。
    ecuc destination uri def RteRipsPluginFillFlushRoutine
      destination-uri-policy destination-uri-nesting-contract=TARGET-CONTAINER:
        container RteRipsPluginFillFlushRoutineFnc [0..*]  # This container describes a Fill-Flush Routine function implemented by a RTE Implementation Plug-In to handle the buffering for implicit communication. Tags: atp.Status=draft / 概述：RteRipsPluginFillFlushRoutineFnc 是用于定义在接收或发送IP数据包时，由RTE调用的填充和刷新例程的函数。 注意：确保该函数与系统中的网络管理策略和数据处理需求相匹配；函数的实现必须确保数据的完整性和安全性；在AUTOSAR CP 4.4标准中，此配置项的具体属性应详细检查以符合标准规范。
          enumeration RteRipsModeDisablingHandling: {RTE_RIPS_CONSIDER_MODE_DISABLINGS, RTE_RIPS_IGNORE_MODE_DISABLINGS}  # This parameter configures whether mode disabling dependencies are considered for the invocation of Rte_Rips_FillFlushRoutines. Tags: atp.Status=draft / 概述：RteRipsModeDisablingHandling配置项用于定义AUTOSAR RTE（Run-Time Environment）如何处理模式切换时的禁用中断和调度器锁定。 注意：在配置此项时，需确保系统的实时性和安全性不受影响；不恰当的配置可能导致系统响应时间增加或任务调度不当；AUTOSAR CP 4.4标准中未明确定义此配置项，需参考具体的RTE实现和系统需求。
          enumeration RteRipsOsSchedulePoint [0..1]: {NONE, UNCONDITIONAL}  # Introduce a schedule point by explicitly calling Os Schedule service after the execution of the Rte_Rips_FillFlushRoutine. Tags: atp.Status=draft / 概述：RteRipsOsSchedulePoint 用于定义在操作系统调度中的特定点，允许运行实体（Runnable）在这些预设点被调度执行。 注意：该配置项应与操作系统的调度策略紧密协调，以确保系统的实时性和性能；配置时需考虑系统的资源分配和优先级设置；在多核系统中，还需注意任务在不同核心间的同步和负载均衡。
          function name RteRipsPluginFillFlushRoutineFncSymbol  # C-Symbol of the Rte_Rips_FillFlushRoutine function. Tags: atp.Status=draft / 概述：RteRipsPluginFillFlushRoutineFncSymbol配置项用于定义RTE生成代码中，与RIPS插件相关的填充和刷新例程的函数符号名称，这些例程负责管理插件的数据交换。 注意：该配置项的命名需要遵循项目的命名规范，以确保一致性和可读性；在多插件系统中，确保每个插件的填充和刷新例程的函数符号名称唯一，避免命名冲突；该配置项在AUTOSAR CP 4.4标准中可能不直接对应，因为它涉及到具体实现细节，所以需要根据项目需求和工具支持进行适当配置。
package /AUTOSAR/LifeCycleInfoSets
  life cycle info set AUTOSARParameterDefinition
    life-cycle-infos:
      lc-object=AdcGroupEcucPartitionRef, lc-state=draft
      lc-object=AdcEcucPartitionRef, lc-state=draft
      lc-object=AdcKernelEcucPartitionRef, lc-state=draft
      lc-object=ArtiConstant, lc-state=draft
      lc-object=ArtiConstantString, lc-state=draft
      lc-object=ArtiExpression, lc-state=draft
      lc-object=ArtiExpressionString, lc-state=draft
      lc-object=ArtiHook, lc-state=draft
      lc-object=ArtiHookClass, lc-state=draft
      lc-object=ArtiHookEventName, lc-state=draft
      lc-object=ArtiHookInstance, lc-state=draft
      lc-object=ArtiHookEventParameterTypeRef, lc-state=draft
      lc-object=ArtiHookInstanceParameterTypeRef, lc-state=draft
      lc-object=ArtiObjectClassParameter, lc-state=draft
      lc-object=ArtiParameterTypeMapRef, lc-state=draft
      lc-object=ArtiObjectInstanceParameter, lc-state=draft
      lc-object=ArtiConstantRef, lc-state=draft
      lc-object=ArtiExpressionRef, lc-state=draft
      lc-object=ArtiHookRef, lc-state=draft
      lc-object=ArtiParameterTypeMap, lc-state=draft
      lc-object=ArtiParameterTypeMapPair, lc-state=draft
      lc-object=ArtiParameterTypeMapPairInput, lc-state=draft
      lc-object=ArtiParameterTypeMapPairOutput, lc-state=draft
      lc-object=ArtiGenericComponentClass, lc-state=draft
      lc-object=ArtiGenericComponentClassName, lc-state=draft
      lc-object=ArtiGenericComponentClassParameter, lc-state=draft
      lc-object=ArtiGenericComponentClassParameterName, lc-state=draft
      lc-object=ArtiParameterTypeMapRef, lc-state=draft
      lc-object=ArtiGenericComponentInstance, lc-state=draft
      lc-object=ArtiGenericComponentInstanceName, lc-state=draft
      lc-object=ArtiGenericComponentClassRef, lc-state=draft
      lc-object=ArtiGenericComponentInstanceParameter, lc-state=draft
      lc-object=ArtiConstantRef, lc-state=draft
      lc-object=ArtiExpressionRef, lc-state=draft
      lc-object=ArtiGenericComponentClassParameterRef, lc-state=draft
      lc-object=ArtiHookRef, lc-state=draft
      lc-object=ArtiHwCoreClass, lc-state=draft
      lc-object=ArtiCurrentApplicationClassRef, lc-state=draft
      lc-object=ArtiCurrentTaskClassRef, lc-state=draft
      lc-object=ArtiLastErrorClassRef, lc-state=draft
      lc-object=ArtiHwCoreInstance, lc-state=draft
      lc-object=ArtiCurrentApplicationInstanceRef, lc-state=draft
      lc-object=ArtiCurrentTaskInstanceRef, lc-state=draft
      lc-object=ArtiEcucCoreRef, lc-state=draft
      lc-object=ArtiLastErrorInstanceRef, lc-state=draft
      lc-object=ArtiOsClass, lc-state=draft
      lc-object=ArtiOsAppModeClassRef, lc-state=draft
      lc-object=ArtiOsInstance, lc-state=draft
      lc-object=ArtiOsAppModeEcucRef, lc-state=draft
      lc-object=ArtiOsAppModeInstanceRef, lc-state=draft
      lc-object=ArtiOsEcucRef, lc-state=draft
      lc-object=ArtiOsTaskHookRef, lc-state=draft
      lc-object=ArtiOsTaskClass, lc-state=draft
      lc-object=ArtiOsTaskInstance, lc-state=draft
      lc-object=ArtiGenericComponentInstanceRef, lc-state=draft
      lc-object=ArtiOsTaskEcucRef, lc-state=draft
      lc-object=CanControllerEcucPartitionRef, lc-state=draft
      lc-object=CanTTControllerEcucPartitionRef, lc-state=draft
      lc-object=CanEcucPartitionRef, lc-state=draft
      lc-object=CanTSynGlobalTimeSecureTmacLength, lc-state=draft
      lc-object=CanTSynTxTmacCalculated, lc-state=draft
      lc-object=CanTSynGlobalTimeMinMsgGap, lc-state=draft
      lc-object=CanTSynRxTmacValidated, lc-state=draft
      lc-object=CanTrcvChannelEcucPartitionRef, lc-state=draft
      lc-object=CanTrcvEcucPartitionRef, lc-state=draft
      lc-object=CorTstBackgroundEcucPartitionRef, lc-state=draft
      lc-object=CorTstForegroundEcucPartitionRef, lc-state=draft
      lc-object=CorTstEcucPartitionRef, lc-state=draft
      lc-object=CryptoDriverObjectEcucPartitionRef, lc-state=draft
      lc-object=CryptoEcucPartitionRef, lc-state=draft
      lc-object=DemFreezeFrameRecordTrigger, lc-state=draft
      lc-object=DioPortEcucPartitionRef, lc-state=draft
      lc-object=DioChannelEcucPartitionRef, lc-state=draft
      lc-object=DioChannelGroupEcucPartitionRef, lc-state=draft
      lc-object=DioEcucPartitionRef, lc-state=draft
      lc-object=EepEcucPartitionRef, lc-state=draft
      lc-object=EthCtrlEcucPartitionRef, lc-state=draft
      lc-object=EthEcucPartitionRef, lc-state=draft
      lc-object=EthSwtConfigEcucPartitionRef, lc-state=draft
      lc-object=EthSwtEcucPartitionRef, lc-state=draft
      lc-object=EthTSynGlobalTimeSecureTmacLength, lc-state=draft
      lc-object=EthTSynGlobalTimeMinMsgGap, lc-state=draft
      lc-object=EthTSynTxTmacCalculated, lc-state=draft
      lc-object=EthTSynRxTmacValidated, lc-state=draft
      lc-object=EthTrcvConfigEcucPartitionRef, lc-state=draft
      lc-object=EthTrcvEcucPartitionRef, lc-state=draft
      lc-object=FlsEcucPartitionRef, lc-state=draft
      lc-object=FlsTstEcucPartitionRef, lc-state=draft
      lc-object=FrEcucPartitionRef, lc-state=draft
      lc-object=FrCtrlEcucPartitionRef, lc-state=draft
      lc-object=FrTSynGlobalTimeSecureTmacLength, lc-state=draft
      lc-object=FrTSynUseExtendedMsgFormat, lc-state=draft
      lc-object=FrTSynTxTmacCalculated, lc-state=draft
      lc-object=FrTSynGlobalTimeMinMsgGap, lc-state=draft
      lc-object=FrTSynGlobalTimeTmacTimeout, lc-state=draft
      lc-object=FrTSynRxTmacValidated, lc-state=draft
      lc-object=FrTrcvChannelEcucPartitionRef, lc-state=draft
      lc-object=FrTrcvEcucPartitionRef, lc-state=draft
      lc-object=GptChannelEcucPartitionRef, lc-state=draft
      lc-object=GptEcucPartitionRef, lc-state=draft
      lc-object=GptKernelEcucPartitionRef, lc-state=draft
      lc-object=IcuChannelEcucPartitionRef, lc-state=draft
      lc-object=IcuEcucPartitionRef, lc-state=draft
      lc-object=IcuKernelEcucPartitionRef, lc-state=draft
      lc-object=IpduMContainedPduOffset, lc-state=draft
      lc-object=IpduMPduUpdateBitPosition, lc-state=draft
      lc-object=IpduMContainedPduOffset, lc-state=draft
      lc-object=IpduMPduUpdateBitPosition, lc-state=draft
      lc-object=IPDUM_HEADERTYPE_NONE, lc-state=draft
      lc-object=IPDUM_HEADERTYPE_NONE, lc-state=draft
      lc-object=IpduMUnusedAreasDefault, lc-state=draft
      lc-object=LinEcucPartitionRef, lc-state=draft
      lc-object=LinChannelEcucPartitionRef, lc-state=draft
      lc-object=LinTrcvChannelEcucPartitionRef, lc-state=draft
      lc-object=LinTrcvEcucPartitionRef, lc-state=draft
      lc-object=McuEcucPartitionRef, lc-state=draft
      lc-object=OcuChannelEcucPartitionRef, lc-state=draft
      lc-object=OcuEcucPartitionRef, lc-state=draft
      lc-object=OcuKernelEcucPartitionRef, lc-state=draft
      lc-object=PortPinEcucPartitionRef, lc-state=draft
      lc-object=PortEcucPartitionRef, lc-state=draft
      lc-object=PwmChannelEcucPartitionRef, lc-state=draft
      lc-object=PwmEcucPartitionRef, lc-state=draft
      lc-object=PwmKernelEcucPartitionRef, lc-state=draft
      lc-object=RamTstEcucPartitionRef, lc-state=draft
      lc-object=RamTstBlockParamsEcucPartitionRef, lc-state=draft
      lc-object=RteRipsFillRoutineRef, lc-state=draft
      lc-object=RteRipsFlushRoutineRef, lc-state=draft
      lc-object=RteBswExclusiveAreaResponsibleRipsPluginRef, lc-state=draft
      lc-object=RteModeMachineInstanceResponsibleRipsPluginRef, lc-state=draft
      lc-object=RteDSMQResponsibleRipsPluginRef, lc-state=draft
      lc-object=RteRips, lc-state=draft
      lc-object=RteRipsSupport, lc-state=draft
      lc-object=RteRipsPluginConfigurationRef, lc-state=draft
      lc-object=RteRipsFillRoutineRef, lc-state=draft
      lc-object=RteRipsFlushRoutineRef, lc-state=draft
      lc-object=RteRipsInvocationHandlerRef, lc-state=draft
      lc-object=RteExclusiveAreaResponsibleRipsPluginRef, lc-state=draft
      lc-object=RteModeMachineInstanceResponsibleRipsPluginRef, lc-state=draft
      lc-object=SoAdSocketTcpTlsConnectionRef, lc-state=draft
      lc-object=SpiDeviceEcucPartitionRef, lc-state=draft
      lc-object=SpiEcucPartitionRef, lc-state=draft
      lc-object=SpiKernelEcucPartitionRef, lc-state=draft
      lc-object=TcpIpTlsConfig, lc-state=draft
      lc-object=TcpIpTlsMaxConnections, lc-state=draft
      lc-object=TcpIpTlsCsmRandomGenerateJobRef, lc-state=draft
      lc-object=TcpIpTlsCiphersuites, lc-state=draft
      lc-object=TcpIpTlsCertificateIdentity, lc-state=draft
      lc-object=TcpIpTlsServerNameIdentification, lc-state=draft
      lc-object=TcpIpTlsCiphersuiteDefinition, lc-state=draft
      lc-object=TcpIpTlsCiphersuiteId, lc-state=draft
      lc-object=TcpIpTlsCiphersuiteName, lc-state=draft
      lc-object=TcpIpTlsCiphersuitePriority, lc-state=draft
      lc-object=TcpIpTlsUseAEADCipher, lc-state=draft
      lc-object=TcpIpTlsUsePresharedKeys, lc-state=draft
      lc-object=TcpIpTlsUseSecurityExtensionForceMacThenHash, lc-state=draft
      lc-object=TcpIpTlsVersion, lc-state=draft
      lc-object=TcpIpTlsCiphersuiteWorker, lc-state=draft
      lc-object=TcpIpTlsCipherAEADCipherKeyLength, lc-state=draft
      lc-object=TcpIpTlsCipherEncryptKeyLength, lc-state=draft
      lc-object=TcpIpTlsCipherMacKeyLength, lc-state=draft
      lc-object=TcpIpTlsCipherCsmDecryptJobRef, lc-state=draft
      lc-object=TcpIpTlsCipherCsmDecryptKeyRef, lc-state=draft
      lc-object=TcpIpTlsCipherCsmEncryptJobRef, lc-state=draft
      lc-object=TcpIpTlsCipherCsmEncryptKeyRef, lc-state=draft
      lc-object=TcpIpTlsCipherCsmMacGenerateJobRef, lc-state=draft
      lc-object=TcpIpTlsCipherCsmMacGenerateKeyRef, lc-state=draft
      lc-object=TcpIpTlsCipherCsmMacVerifyJobRef, lc-state=draft
      lc-object=TcpIpTlsCipherCsmMacVerifyKeyRef, lc-state=draft
      lc-object=TcpIpTlsCiphersuiteDefinitionRef, lc-state=draft
      lc-object=TcpIpTlsConnectionHandshakeRef, lc-state=draft
      lc-object=TcpIpTlsHandshake, lc-state=draft
      lc-object=TcpIpTlsCsmPRFSupportType, lc-state=draft
      lc-object=TcpIpTlsCsmHashVerifyJobRef, lc-state=draft
      lc-object=TcpIpTlsCsmKeyExchangeCalcPubValJobRef, lc-state=draft
      lc-object=TcpIpTlsCsmKeyExchangeCalcSecretJobRef, lc-state=draft
      lc-object=TcpIpTlsCsmKeyExchangeDecryptJobRef, lc-state=draft
      lc-object=TcpIpTlsCsmKeyExchangeDecryptKeyRef, lc-state=draft
      lc-object=TcpIpTlsCsmKeyExchangeEncryptJobRef, lc-state=draft
      lc-object=TcpIpTlsCsmKeyExchangeEncryptKeyRef, lc-state=draft
      lc-object=TcpIpTlsCsmKeyExchangeKeyRef, lc-state=draft
      lc-object=TcpIpTlsCsmKeyExchangeSignatureGenerateJobRef, lc-state=draft
      lc-object=TcpIpTlsCsmKeyExchangeSignatureGenerateKeyRef, lc-state=draft
      lc-object=TcpIpTlsCsmKeyExchangeSignatureVerifyJobRef, lc-state=draft
      lc-object=TcpIpTlsCsmKeyExchangeSignatureVerifyKeyRef, lc-state=draft
      lc-object=TcpIpTlsCsmMasterSecretKeyRef, lc-state=draft
      lc-object=TcpIpTlsCsmPrfMacJobRef, lc-state=draft
      lc-object=TcpIpTlsCsmPrfMacKeyRef, lc-state=draft
      lc-object=TcpIpTlsPskIdentity, lc-state=draft
      lc-object=TcpIpTlsPresharedKeyIdentity, lc-state=draft
      lc-object=TcpIpTlsPresharedKeyIdentityHint, lc-state=draft
      lc-object=TcpIpTlsPskGetClientKeyIdentityFunc, lc-state=draft
      lc-object=TcpIpTlsPskGetKeyIdentyHintFunc, lc-state=draft
      lc-object=TcpIpTlsPskGetServerKeyIdentityFunc, lc-state=draft
      lc-object=TcpIpTlsPresharedKeyCsmKeyRef, lc-state=draft
      lc-object=TcpIpTlsConnection, lc-state=draft
      lc-object=TcpIpTlsConnectionGetTimeFunc, lc-state=draft
      lc-object=TcpIpTlsConnectionId, lc-state=draft
      lc-object=TcpIpTlsConnectionType, lc-state=draft
      lc-object=TcpIpTlsMaxFragmentLength, lc-state=draft
      lc-object=TcpIpTlsPortAssignment, lc-state=draft
      lc-object=TcpIpTlsUseClientAuthenticationRequest, lc-state=draft
      lc-object=TcpIpTlsUseSecurityExtensionRecordSizeLimit, lc-state=draft
      lc-object=TcpIpTlsCertificateIdentityRef, lc-state=draft
      lc-object=TcpIpTlsConnectionCiphersuiteWorkerRef, lc-state=draft
      lc-object=TcpIpTlsConnectionGroupRef, lc-state=draft
      lc-object=TcpIpTlsConnectionPskIdentityRef, lc-state=draft
      lc-object=TcpIpTlsIpAddressAssignment, lc-state=draft
      lc-object=TcpIpTlsConnectionGroup, lc-state=draft
      lc-object=WEthCtrlEcucPartitionRef, lc-state=draft
      lc-object=WEthEcucPartitionRef, lc-state=draft
      lc-object=WEthTrcvConfigEcucPartitionRef, lc-state=draft
      lc-object=WEthTrcvEcucPartitionRef, lc-state=draft
      lc-object=WdgEcucPartitionRef, lc-state=draft
