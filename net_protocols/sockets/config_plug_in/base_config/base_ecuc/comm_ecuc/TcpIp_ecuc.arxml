AUTOSAR XML (schema 00046)
package /ActiveEcuC
  module config TcpIp: implementation-config-variant=VARIANT-PRE-COMPILE
    TcpIpConfig
      TcpIpSocketOwnerConfig
        SoAd (TcpIpSocketOwner):
          TcpIpSocketOwnerUpperLayerType = SOAD
          TcpIpSocketOwnerTcpIpEventName = 
          TcpIpSocketOwnerCopyTxDataName = 
          TcpIpSocketOwnerHeaderFileName = 
          TcpIpSocketOwnerLocalIpAddrAssignmentChgName = 
          TcpIpSocketOwnerRxIndicationName = 
          TcpIpSocketOwnerTcpAcceptedName = 
          TcpIpSocketOwnerTcpConnectedName = 
          TcpIpSocketOwnerTxConfirmationName = 
      TcpIpTcpConfig:
        TcpIpTcpCongestionAvoidanceEnabled = false
        TcpIpTcpFastRecoveryEnabled = false
        TcpIpTcpFastRetransmitEnabled = false
        TcpIpTcpKeepAliveEnabled = true
        TcpIpTcpNagleEnabled = true
        TcpIpTcpSlowStartEnabled = false
        TcpIpTcpFinWait2Timeout = 120
        TcpIpTcpKeepAliveInterval = 1
        TcpIpTcpKeepAliveTime = 7200
        TcpIpTcpMsl = 120
        TcpIpTcpRetransmissionTimeout = 10
        TcpIpTcpSynReceivedTimeout = 20
        TcpIpTcpKeepAliveProbesMax = 3
        TcpIpTcpMaxRtx = 12
        TcpIpTcpReceiveWindowMax = 14600
        TcpIpTcpSynMaxRtx = 12
        TcpIpTcpTtl = 64
        TcpIpTcpSendBufferMax = 12
      TcpIpUdpConfig: TcpIpUdpTtl=64
      TcpIpIpConfig
        TcpIpIpV4Config
          TcpIpIcmpConfig: TcpIpIcmpEchoReplyEnabled=true, TcpIpIcmpTtl=64
          TcpIpIpFragmentationConfig: TcpIpIpFragmentationRxEnabled=false, TcpIpIpReassTimeout=0, TcpIpIpNumFragments=0, TcpIpIpNumReassDgrams=0
          TcpIpArpConfig:
            TcpIpArpPacketQueueEnabled = true
            TcpIpArpRequestTimeout = 5
            TcpIpArpTableEntryTimeout = 3600
            TcpIpArpNumGratuitousARPonStartup = 3
            TcpIpArpTableSizeMax = 10
            TcpIpStaticArpEntry: TcpIpStaticArpEntryIpAddr=255.255.255.255, TcpIpStaticArpEntryPhysAddr=FF-FF-FF-FF-FF-FF
      TcpIpCtrl_Vlan_DoIP (TcpIpCtrl): TcpIpIpFramePrioDefault=2, TcpIpDhcpServerConfigRef=(unset), TcpIpEthIfCtrlRef=/ActiveEcuC/EthIf/EthIfConfigSet/EthIfController_Vlan10_DoIP
      TcpIpLocalAddr_TcpIpCtrl_Vlan_DoIP_Unicast (TcpIpLocalAddr):
        TcpIpAddrId = 3
        TcpIpAddressType = TCPIP_UNICAST
        TcpIpDomainType = TCPIP_AF_INET
        TcpIpCtrlRef = /ActiveEcuC/TcpIp/TcpIpConfig/TcpIpCtrl_Vlan_DoIP
        TcpIpLocalAddrIPv6ExtHeaderFilterRef = (unset)
        TcpIpAddrAssignment: TcpIpAssignmentPriority=1, TcpIpAssignmentLifetime=TCPIP_FORGET, TcpIpAssignmentMethod=TCPIP_STATIC, TcpIpAssignmentTrigger=TCPIP_AUTOMATIC
        TcpIpStaticIpAddressConfig: TcpIpNetmask=24, TcpIpDefaultRouter=192.168.10.32, TcpIpStaticIpAddress=192.168.10.71
      4 x TcpIpBufferMemoryConfig:
        TcpIpBufferMemoryConfig: TcpIpBufferMemoryLen=128, TcpIpBufferMemoryNum=50
        TcpIpBufferMemoryConfig_1: TcpIpBufferMemoryLen=256, TcpIpBufferMemoryNum=15
        TcpIpBufferMemoryConfig_2: TcpIpBufferMemoryLen=512, TcpIpBufferMemoryNum=10
        TcpIpBufferMemoryConfig_3: TcpIpBufferMemoryLen=1540, TcpIpBufferMemoryNum=6
    TcpIpGeneral:
      TcpIpGetAndResetMeasurementDataApi = false
      TcpIpBufferMemory = 0
      TcpIpDevErrorDetect = true
      TcpIpDhcpServerEnabled = false
      TcpIpMainFunctionPeriod = 0.005
      TcpIpResetIpAssignmentApi = false
      TcpIpTcpEnabled = true
      TcpIpTcpSocketMax = 14
      TcpIpUdpEnabled = true
      TcpIpUdpSocketMax = 30
      TcpIpVersionInfoApi = true
      TcpIpScalabilityClass = SC1
      TcpIpIpV4General:
        TcpIpArpEnabled = true
        TcpIpAutoIpEnabled = false
        TcpIpDhcpClientEnabled = false
        TcpIpIcmpEnabled = true
        TcpIpIpV4Enabled = true
        TcpIpLocalAddrIpv4EntriesMax = 5
        TcpIpPathMtuDiscoveryEnabled = false
