AUTOSAR XML (schema 00046)
package /ActiveEcuC
  module config Com: implementation-config-variant=VARIANT-PRE-COMPILE, module-description=Com_Impl
    ComConfig: ComDataMemSize=0, ComMaxIPduCnt=0
      Com_MainFunction_Rx (ComMainFunctionRx): MainRxTimeBase=0.005
      Com_MainFunction_Tx (ComMainFunctionTx): MainTxTimeBase=0.005
      Com_MainFunction_Gw (ComMainFunctionGw): MainGwTimeBase=0.005
    ComGeneral:
      ComCancellationSupport = true
      ComConfigurationUseDet = false
      ComEnableMDTForCyclicTransmission = true
      ComEnableSignalGroupArrayApi = false
      ComMetaDataSupport = false
      ComRetryFailedTransmitRequests = false
      ComVersionInfoApi = false
      ComSupportedIPduGroups = 0
      ComUserCbkHeaderFile = (unset)
