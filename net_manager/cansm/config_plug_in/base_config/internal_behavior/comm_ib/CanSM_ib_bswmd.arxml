AUTOSAR XML (schema 00048)
package /AUTOSAR/CanSM_ib_bswmd/BswModuleDescriptions
  bsw module description CanSM: provided-entrys=CanSM_MainFunction
    bsw internal behavior CanSMBehavior
      exclusive area CANSM_EXCLUSIVE_AREA_0
      bsw schedulable entity CanSM_MainFunction: implemented-entry=CanSM_MainFunction
      bsw timing event CanSM_MainFunctionTimingEvent0: starts-on-event=CanSM_MainFunction, period=0.005
  bsw module entry CanSM_MainFunction: call-type=SCHEDULED, execution-context=TASK
