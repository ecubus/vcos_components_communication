AUTOSAR XML (schema 00046)
package /ActiveEcuC
  module config Nm: implementation-config-variant=VARIANT-PRE-COMPILE, module-description=Nm_Impl
    NmGlobalConfig
      NmGlobalFeatures:
        NmBusSynchronizationEnabled = false
        NmCarWakeUpRxEnabled = false
        NmComControlEnabled = true
        NmCoordinatorSupportEnabled = false
        NmCoordinatorSyncSupport = false
        NmPduRxIndicationEnabled = false
        NmRemoteSleepIndEnabled = false
        NmStateChangeIndEnabled = true
        NmUserDataEnabled = true
        NmGlobalCoordinatorTime = 0
        NmCarWakeUpCallout = 
      NmGlobalConstants: NmNumberOfChannels=1
      NmGlobalProperties: NmDevErrorDetect=true, NmVersionInfoApi=false, NmCycletimeMainFunction=0.005
