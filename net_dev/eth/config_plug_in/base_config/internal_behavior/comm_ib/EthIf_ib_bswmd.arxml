AUTOSAR XML (schema 00046)
package /AUTOSAR/EthIf_ib_bswmd/BswModuleDescriptions
  bsw module description EthIf: provided-entrys=ethif_mainfunction_state
    bsw internal behavior EthIfBehavior
      bsw schedulable entity ethif_mainfunction_state: implemented-entry=ethif_mainfunction_state
      bsw timing event EthIf_MainFunctionStateTimingEvent0: starts-on-event=ethif_mainfunction_state, period=0.1
  bsw module entry ethif_mainfunction_state: call-type=SCHEDULED, execution-context=TASK
