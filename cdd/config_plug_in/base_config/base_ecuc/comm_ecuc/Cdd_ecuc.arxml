AUTOSAR XML (schema 00046)
package /ActiveEcuC
  module config Cdd: implementation-config-variant=VARIANT-PRE-COMPILE
    CddComStackContribution
      CddPduRUpperLayerContribution
        CddPduRUpperLayerTxPdu: CddPduRUpperLayerHandleId=0, CddPduRApiType=IF, CddPduRUpperLayerPduRef=<empty>
        CddPduRUpperLayerRxPdu: CddPduRUpperLayerHandleId=1, CddPduRApiType=IF, CddPduRUpperLayerPduRef=<empty>
      CddComIfUpperLayerContribution
        CddComIfUpperLayerTxPdu: CddComIfHandleId=2, CddComIfPduRef=<empty>
        CddComIfUpperLayerRxPdu: CddComIfHandleId=3, CddComIfPduRef=<empty>
