AUTOSAR XML (schema 00046)
package /ActiveEcuC
  module config CanNm: implementation-config-variant=VARIANT-PRE-COMPILE, module-description=CanNm_Impl
    CanNmGlobalConfig:
      CanNmBusLoadReductionEnabled = false
      CanNmBusSynchronizationEnabled = false
      CanNmComControlEnabled = true
      CanNmComUserDataSupport = true
      CanNmCoordinatorSyncSupport = false
      CanNmDevErrorDetect = false
      CanNmGlobalPnSupport = false
      CanNmImmediateRestartEnabled = false
      CanNmImmediateTxconfEnabled = false
      CanNmPassiveModeEnabled = false
      CanNmPduRxIndicationEnabled = false
      CanNmPnEiraCalcEnabled = false
      CanNmRemoteSleepIndEnabled = false
      CanNmStateChangeIndEnabled = true
      CanNmUserDataEnabled = true
      CanNmVersionInfoApi = false
      CanNmPnResetTime = 1.95
      CanNmTransmitCalloutFunc = (unset)
      CanNmPnEiraRxNSduRef = 
      CanNmPnInfo: CanNmPnInfoLength=2, CanNmPnInfoOffset=5
        CanNmPnFilterMaskByte: CanNmPnFilterMaskByteIndex=5, CanNmPnFilterMaskByteValue=91
        CanNmPnFilterMaskByte_1 (CanNmPnFilterMaskByte): CanNmPnFilterMaskByteIndex=6, CanNmPnFilterMaskByteValue=5
      CanNm_MainFunction (CanNmMainFunction): CanNmMainFunctionPeriod=0.005
