AUTOSAR XML (schema 00046)
package /ActiveEcuC
  module config EthIf: implementation-config-variant=VARIANT-PRE-COMPILE
    EthIfConfigSet
      EthIfTxConfirmationConfig: EthIfTxConfirmationFunction=IpV4_Ip_TxConfirmation, FrameOwnerRef=/ActiveEcuC/EthIf/EthIfConfigSet/TcpIp_IPv4
      TcpIp_IPv4 (EthIfFrameOwnerConfig): EthIfFrameType=2048, EthIfOwner=0
      TcpIp_IPv4_RxIndication (EthIfRxIndicationConfig): EthIfRxIndicationFunction=IpV4_Ip_RxIndication, FrameOwnerRef=/ActiveEcuC/EthIf/EthIfConfigSet/TcpIp_IPv4
      EthSM_LinkStateChgCbk (EthIfTrcvLinkStateChgConfig): EthIfTrcvLinkStateChgFunction=EthSM_TrcvLinkStateChg
      EthIfPhysController: EthIfPhysControllerIdx=0, EthIfEthCtrlRef=(unset), EthIfWEthCtrlRef=(unset)
      EthIfTransceiver: EthIfTransceiverIdx=0, EthIfEthTrcvRef=(unset), EthIfWEthTrcvRef=(unset)
      EthIfController_Vlan10_DoIP (EthIfController):
        EthIfCtrlIdx = 1
        EthIfCtrlMtu = 1500
        EthIfMaxTxBufsTotal = (unset)
        EthIfVlanId = 10
        EthIfSwitchRefOrPortGroupRef = (unset)
        EthIfEthTrcvRef = /ActiveEcuC/EthIf/EthIfConfigSet/EthIfTransceiver
        EthIfPhysControllerRef = /ActiveEcuC/EthIf/EthIfConfigSet/EthIfPhysController
      EthIfController_Vlan92_Tsyn (EthIfController):
        EthIfCtrlIdx = 0
        EthIfCtrlMtu = 1500
        EthIfMaxTxBufsTotal = (unset)
        EthIfVlanId = 92
        EthIfSwitchRefOrPortGroupRef = (unset)
        EthIfEthTrcvRef = /ActiveEcuC/EthIf/EthIfConfigSet/EthIfTransceiver
        EthIfPhysControllerRef = /ActiveEcuC/EthIf/EthIfConfigSet/EthIfPhysController
      TcpIp_ARP (EthIfFrameOwnerConfig): EthIfFrameType=2054, EthIfOwner=1
      EthTSyn_EthTSyn (EthIfFrameOwnerConfig): EthIfFrameType=35063, EthIfOwner=2
      TcpIp_ARP_RxIndication (EthIfRxIndicationConfig): EthIfRxIndicationFunction=IpV4_Arp_RxIndication, FrameOwnerRef=/ActiveEcuC/EthIf/EthIfConfigSet/TcpIp_ARP
      EthTSyn_RxIndication_EthTSyn (EthIfRxIndicationConfig): EthIfRxIndicationFunction=EthTSyn_RxIndication, FrameOwnerRef=/ActiveEcuC/EthIf/EthIfConfigSet/EthTSyn_EthTSyn
      EthTSyn_TrcvLinkStateChg_EthTSyn (EthIfTrcvLinkStateChgConfig): EthIfTrcvLinkStateChgFunction=EthTSyn_TrcvLinkStateChg
      EthTSyn_TxConfirmation_EthTSyn (EthIfTxConfirmationConfig): EthIfTxConfirmationFunction=EthTSyn_TxConfirmation, FrameOwnerRef=/ActiveEcuC/EthIf/EthIfConfigSet/EthTSyn_EthTSyn
    EthIfGeneral:
      EthIfDevErrorDetect = true
      EthIfEnableRxInterrupt = true
      EthIfEnableTxInterrupt = true
      EthIfGetBaudRate = (unset)
      EthIfGetCounterState = (unset)
      EthIfMainFunctionPeriod = 0.005
      EthIfMaxTrcvsTotal = 1
      EthIfRxIndicationIterations = 5
      EthIfStartAutoNegotiation = (unset)
      EthIfTrcvLinkStateChgMainReload = 5
      EthIfVersionInfoApi = false
      EthIfVersionInfoApiMacro = false
      EthIfEnableSignalQualityApi = (unset)
      EthIfEnableWEthApi = false
      EthIfGetAndResetMeasurementDataApi = false
      EthIfGetCtrlIdxList = false
      EthIfGetTransceiverWakeupModeApi = false
      EthIfGetVlanIdSupport = false
      EthIfGlobalTimeSupport = true
      EthIfSetForwardingModeApi = false
      EthIfSwitchManagementSupport = (unset)
      EthIfVerifyConfigApi = false
      EthIfWakeUpSupport = false
      EthIfMainFunctionStatePeriod = 0.1
      EthIfPortStartupActiveTime = (unset)
      EthIfSignalQualityCheckPeriod = (unset)
      EthIfSwitchOffPortTimeDelay = (unset)
      EthIfMapMcalApiPrefix = Eth_17_GEthMac
      EthIfPublicCddHeaderFile = (unset)
