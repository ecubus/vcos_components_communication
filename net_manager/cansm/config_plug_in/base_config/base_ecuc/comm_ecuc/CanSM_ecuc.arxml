AUTOSAR XML (schema 00046)
package /ActiveEcuC
  module config CanSM: implementation-config-variant=VARIANT-PRE-COMPILE, module-description=CanSM_Impl
    CanSMGeneral:
      CanSMDevErrorDetect = false
      CanSMIcomSupport = false
      CanSMPncSupport = false
      CanSMSetBaudrateApi = false
      CanSMTxOfflineActiveSupport = false
      CanSMVersionInfoApi = false
      CanSMGetBusOffDelayFunction = (unset)
      BusOffBeginFunction = (unset)
      BusOffEndFunction = (unset)
      CanSMGetBusOffDelayHeader = (unset)
    CanSMConfiguration: CanSMModeRequestRepetitionTime=0.1, CanSMModeRequestRepetitionMax=10
      CanSM_MainFunction (CanSMMainFunction): CanSMMainFunctionPeriod=0.005
