AUTOSAR XML (schema 00046)
package /ActiveEcuC
  module config PduR: implementation-config-variant=VARIANT-PRE-COMPILE, module-description=PduR_Impl
    PduRGeneral: PduRDevErrorDetect=false, PduRMetaDataSupport=false, PduRSpinlockRetryCounter=3, PduRVersionInfoApi=false, PduRZeroCostOperation=false
    PduRRoutingPaths: PduRConfigurationId=0, PduRMaxRoutingPathCnt=65535, PduRMaxRoutingPathGroupCnt=65535
