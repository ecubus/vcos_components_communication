AUTOSAR XML (schema 00046)
package /ActiveEcuC
  module config ComM: implementation-config-variant=VARIANT-PRE-COMPILE, module-description=ComM_Impl
    ComMGeneral:
      ComM0PncVectorAvoidance = false
      ComMDevErrorDetect = false
      ComMDirectUserMapping = false
      ComMModeLimitationEnabled = false
      ComMPncGatewayEnabled = false
      ComMPncSupport = false
      ComMResetAfterForcingNoComm = false
      ComMSynchronousWakeUp = true
      ComMVersionInfoApi = false
      ComMWakeupInhibitionEnabled = false
      ComMPncPrepareSleepTimer = 0
      ComMTMinFullComModeDuration = 5
      ComMEcuGroupClassification = 3
      ComMGlobalNvMBlockDescriptor = <empty>
    ComMConfigSet: ComMPncEnabled=false
