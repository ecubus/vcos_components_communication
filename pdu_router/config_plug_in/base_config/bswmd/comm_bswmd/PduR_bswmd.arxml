AUTOSAR XML (schema 00046)
package /AUTOSAR/EcucDefs
  module definition PduR [0..1]: post-build-variant-support=true, variants post-build/pre-compile  # Configuration of the PduR (PDU Router) module.
    container PduRBswModules [0..65535]: multiplicity set at pre-compile  # Each container describes a specific BSW module (upper/CDD/lower/IpduM) that the PDU Router shall interface to. | The reason to have it as own configuration container instead of implication of the routing path is to be able to configure CDDs properly and to force module's to be used in a post-build situation even though no routing is made to/from this module (future configurations may include these modules).
      boolean PduRCancelReceive: set at pre-compile  # Specifies if the Transport protocol module supports the CancelReceive API or not. Value true the API is supported.
      boolean PduRCancelTransmit: set at pre-compile  # Specifies if the BSW module supports the CancelTransmit API or not. Value true the API is supported.
      boolean PduRCommunicationInterface: set at pre-compile  # Specifies if the BSW module supports the Communication Interface APIs or not. Value true the APIs are supported. | A module can have both Communication Interface APIs and Transport Protocol APIs (e.g. the COM module).
      boolean PduRLowerModule: set at pre-compile  # The PduRLowerModule will decide who will call the APIs and who will implement the APIs. | For example, if the CanIf module is referenced then the PDU Router module will implement the PduR_CanIfRxIndication API. And the PDUR module will call the CanIf_Transmit API. Other APIs are of course also covered. An upper module can also be an lower module (e.g. the IpduM module).
      boolean PduRRetransmission: set at pre-compile  # If set to true this means that the destination transport protocol module will use the retransmission feature. This parameter might be set to false if the retransmission feature is not used, even though the destination transport protocol is supporting it. | This parameter is only valid for transport protocol modules and gateway operations. If transmission from a local upper layer module this module will handle the retransmission.
      boolean PduRTransportProtocol: set at pre-compile  # The PDU Router module shall use the API parameters specified for transport protocol interface.
      boolean PduRTriggertransmit: set at pre-compile  # Specifies if the BSW module supports the TriggerTransmit API or not. Value true means that the BSW module supports the TriggerTransmit interface which a lower layer module can call and also that it can call the TriggerTransmit interface of an upper layer module. Value false means that the BSW module does not support the TriggerTransmit interface which a lower layer module can call and also that it shall not call the TriggerTransmit interface of an upper layer module.
      boolean PduRTxConfirmation: set at pre-compile  # Specifies if the BSW module supports the TxConfirmation API or not. Value true the API is supported.
      boolean PduRUpperModule: set at pre-compile  # The PduRUpperModule will decide who will call the APIs and who will implement the APIs. | For example, if the COM module is referenced then the PDU Router module will implement the PduR_Transmit API. And the PDUR module will call the Com_RxIndication API. Other APIs are of course also covered. An upper module can also be an lower module (e.g. the IpduM module).
      boolean PduRUseTag: set at pre-compile  # This parameter, if set to true, enables the usage of the tag (<up>) in the following API calls: | * PduR_<Up>CancelReceive * PduR_<Up>CancelTransmit Example: If used by COM and the parameter is enabled the PduR_ComCancelTransmit is used. The background is that upper layer modules differ in usage of this tag (e.g. COM is using the tag, DCM is not).
      foreign reference PduRBswModuleRef: set at pre-compile, destination-type=ECUC-MODULE-CONFIGURATION-VALUES  # This is a reference to one BSW module's configuration (i.e. not the ECUC parameter definition template). | Example, there could be several configurations of LinIf and this reference selects one of them.
    container PduRGeneral  # This container is a subcontainer of PduR and specifies the general configuration parameters of the PDU Router.
      boolean PduRDevErrorDetect: set at pre-compile, default-value=false  # Switches the development error detection and notification on or off. | * true: detection and notification is enabled. * false: detection and notification is disabled.
      boolean PduRMetaDataSupport [0..1]: multiplicity set at pre-compile, set at pre-compile, default-value=false  # Enable support for MetaData handling. The MetaData is defined by the referenced MetaDataType of the global PDU definitions. This feature may be used for efficient address based routing and generic CAN-CAN-routing, where the MetaData contains the CAN ID.
      integer PduRSpinlockRetryCounter: 0..255, set at link in variant link-time+post-build / pre-compile in variant pre-compile, default-value=3  # Defines the number of PduR spin lock retry.
      boolean PduRVersionInfoApi: set at pre-compile, default-value=false  # If true the PduR_GetVersionInfo API is available.
      boolean PduRZeroCostOperation: set at pre-compile  # If set the PduR configuration generator will report an error if zero-cost-operation cannot be fulfilled. | This parameter shall be seen as an input requirement to the configuration generator.
    container PduRRoutingPaths  # Represents one table of routing paths. | This routing table allows multiple configurations that can be used to create several routing tables in the same configuration. This is mainly used for post-build (e.g. post-build selectable) but can be used by pre-compile and link-time for variant handling.
      integer PduRConfigurationId: 0..65535, post-build-variant-value=true, set at post-build in variant post-build / pre-compile in variant pre-compile  # Identification of the configuration of the PduR configuration. This identification can be read using the PduR API.
      integer PduRMaxRoutingPathCnt [0..1]: 0..65535, multiplicity set at pre-compile, set at pre-compile  # Maximum number of RoutingPaths in all RoutingTables. This parameter is needed only in case of post-build loadable implementation using static memory allocation.
      integer PduRMaxRoutingPathGroupCnt [0..1]: 0..65535, multiplicity set at pre-compile, set at pre-compile  # Maximum number of RoutingPathGroups. This parameter is needed only in case of post-build loadable implementation using static memory allocation.
      container PduRDestPdu [0..65535]: multiplicity set at post-build in variant post-build / pre-compile in variant pre-compile, post-build-variant-multiplicity=true  # This container is a subcontainer of PduRRoutingPath and specifies one destination for the PDU to be routed.
        boolean PduRTransmissionConfirmation: multiplicity set at pre-compile, set at pre-compile  # This parameter is only for communication interfaces. Transport protocol modules will always call the TxConfirmation function. | If set the destination communication interface module will call the TxConfirmation. However the TxConfirmation may be not called due to error. So the PduR shall not block until the TxConfirmation is called. One background for this parameter is for the PduR to know when all modules have confirmed a multicast operation.
        enumeration PduRDestPduDataProvision [0..1]: {PDUR_DIRECT, PDUR_TRIGGERTRANSMIT}, multiplicity set at post-build in variant post-build / pre-compile in variant pre-compile, post-build-variant-multiplicity=true, post-build-variant-value=true, set at post-build in variant post-build / pre-compile in variant pre-compile, default-value=PDUR_DIRECT  # Specifies how data are provided: direct (as part of the Transmit call) or via | the TriggerTransmit callback function. Only required for non-TP gatewayed I-PDUs.
        enumeration PduRDestPduLengthHandlingStrategy [0..1]: {PDUR_STRATEGY_UNUSED, PDUR_STRATEGY_SHORTEN, PDUR_STRATEGY_DISCARD, PDUR_STRATEGY_IGNORE}, multiplicity set at post-build in variant post-build / pre-compile in variant pre-compile, post-build-variant-multiplicity=true, post-build-variant-value=true, set at post-build in variant post-build / pre-compile in variant pre-compile, default-value=PDUR_STRATEGY_UNUSED  # Pdu length handling strategy while destination Pdu lengh is langer than Pdu length in EcuC | This parameter is only used for communication interface routings. It is ignored for transmport protocol routings.
        integer PduRDestPduHandleId [0..1]: 0..65535, scope=ECU, multiplicity set at pre-compile, set at pre-compile, symbolic-name-value=true  # PDU identifier assigned by PDU Router. Used by communication interface and transport protocol modules for confirmation (PduR_<Lo>TxConfirmation) and for TriggerTransmit (PduR_<Lo>TriggerTransmit).
        reference PduRDestPduRef: post-build-variant-value=true, set at post-build in variant post-build / pre-compile in variant pre-compile, destination=Pdu  # Destination PDU reference; reference to unique PDU identifier which shall be used by the PDU Router instead of the source PDU ID when calling the related function of the destination module.
      container PduRRoutingPath [0..65535]: multiplicity set at post-build in variant post-build / pre-compile in variant pre-compile, post-build-variant-multiplicity=true  # This container is a subcontainer of PduRRoutingTable and specifies the routing path of a PDU.
        integer PduRQueueDepth [0..1]: 1..255, multiplicity set at post-build in variant post-build / pre-compile in variant pre-compile, post-build-variant-multiplicity=true, post-build-variant-value=true, set at post-build in variant post-build / pre-compile in variant pre-compile, default-value=1  # This parameter defines the queue depth for this routing path.
        integer PduRTpThreshold [0..1]: 0..65535, multiplicity set at post-build in variant post-build / pre-compile in variant pre-compile, post-build-variant-multiplicity=true, post-build-variant-value=true, set at post-build in variant post-build / pre-compile in variant pre-compile  # This parameter is only relevant for TP routings. | When configured, it enables on-the-fly routing and defines the number of bytes which must have been received before transmission on the destination bus may start. When omitted, direct TP routing is enforced. The PduRouter shall ensure that a buffer is allocated for this routing path which is at least as large as the threshold.
        reference PduRDestPduRRef [1..255]: post-build-variant-value=true, set at post-build in variant post-build / pre-compile in variant pre-compile, destination=PduRDestPdu
        reference PduRDestTxBufferRef [0..65535]: multiplicity set at post-build in variant post-build / pre-compile in variant pre-compile, post-build-variant-multiplicity=true, post-build-variant-value=true, set at post-build in variant post-build / pre-compile in variant pre-compile, destination=PduRTxBuffer  # Reference to a buffer in the PduR. This buffer is required for communication interface gatewaying, and for transport protocol gatewaying.
        reference PduRSrcPduRRef: post-build-variant-value=true, set at post-build in variant post-build / pre-compile in variant pre-compile, destination=PduRSrcPdu
        container PduRDefaultValue [0..1]  # Specifies the default value of the I-PDU. Only required for gateway operation and if at least one PDU specified by PduRDestPdu uses TriggerTransmit Data provision. | Represented as an array of IntegerParamDef.
          container PduRDefaultValueElement [0..255]: multiplicity set at post-build in variant post-build / pre-compile in variant pre-compile, post-build-variant-multiplicity=true  # Each value element is represented by the element and the position in an array.
            integer PduRDefaultValueElement: 0..255, post-build-variant-value=true, set at post-build in variant post-build / pre-compile in variant pre-compile  # The default value consists of a number of elements. Each element is one byte long and the number of elements is specified by SduLength. The position of this parameter in the container is specified by the PduRElementBytePosition parameter.
            integer PduRDefaultValueElementBytePosition: 0..4294967294, post-build-variant-value=true, set at post-build in variant post-build / pre-compile in variant pre-compile  # This parameter specifies the byte position of the element within the default value
      container PduRRoutingPathGroup [0..65535]: multiplicity set at post-build in variant post-build / pre-compile in variant pre-compile, post-build-variant-multiplicity=true  # This container groups routing path destinations. Destinations are used instead of routing paths since a routing path can be 1:n. It is desirable to be able to enable/disable a specific bus (i.e. a destination) rather than a routing path. Of course it is possible to create groups that covers specific routing paths as well. | Enabling and disabling of routing path groups are made using the PduR API
        boolean PduRIsEnabledAtInit: post-build-variant-value=true, set at post-build in variant post-build / pre-compile in variant pre-compile  # If set to true this routing path group will be enabled after initializing the PDU Router module (i.e. enabled in the PduR_Init function).
        integer PduRRoutingPathGroupId: 0..65535, scope=ECU, set at pre-compile, symbolic-name-value=true  # Identification of the routing group. | The identification will be used by the disable/enable API in the PDU Router module API.
        reference PduRDestPduRRef [1..255]: post-build-variant-value=true, set at post-build in variant post-build / pre-compile in variant pre-compile, destination=PduRDestPdu
      container PduRSrcPdu [0..65535]  # This container is a subcontainer of PduRRoutingPath and specifies the source of the PDU to be routed.
        boolean PduRSrcPduUpTxConf: scope=ECU, multiplicity set at post-build in variant post-build / pre-compile in variant pre-compile, post-build-variant-multiplicity=true, post-build-variant-value=true, set at post-build in variant post-build / pre-compile in variant pre-compile, default-value=true  # When enabled, the TxConfirmation will be | forwarded to the upper layer. Prerequisites: Lower layer and upper layer support TxConfirmation.
        integer PduRSourcePduBlockSize [0..1]: 1..4294967295, multiplicity set at post-build in variant post-build / pre-compile in variant pre-compile, post-build-variant-multiplicity=true, post-build-variant-value=true, set at post-build in variant post-build / pre-compile in variant pre-compile  # Minimum amount of buffer space required by receiving transport protocol layer to continue reception.
        integer PduRSourcePduHandleId: 0..65535, scope=ECU, set at pre-compile, symbolic-name-value=true  # PDU identifier assigned by PDU Router.
        reference PduRSrcPduRef: post-build-variant-value=true, set at post-build in variant post-build / pre-compile in variant pre-compile, destination=Pdu  # Source PDU reference; reference to unique PDU identifier which shall be used for the requested PDU Router operation.
      container PduRTxBuffer [0..65535]: multiplicity set at pre-compile  # Specifies a buffer used for gatewaying via communication interfaces or transport protocols.
        integer PduRPduMaxLength: 1..65535, set at pre-compile  # Length of the Tx buffer in bytes. This parameter limits the size of buffered routed PDUs.
      container PduRBufferPool [0..255]: multiplicity set at pre-compile  # Specifies a buffer used for event cache situation.
        integer PduRBufferPoolBlockSize: 1..65535, set at pre-compile, default-value=8  # Length of buffer poll block.
        integer PduRBufferPoolBlockNumber: 1..65535, set at pre-compile, default-value=10  # Number of buffer poll block.
    container PduRMainFunction [0..255]: multiplicity set at pre-compile, post-build-variant-multiplicity=true  # Contains the configuration parameters of the AUTOSAR PduR module's PduRMainFunction. / 概述：PduRMainFunction是一个配置项，用于定义PduR模块的主函数，这些主函数用于taskmapping。在未添加本项实例时，生成的默认主函数周期为1ms 注意：在配置PduRMainFunction时，需要确保其与taskmapping功能相匹配；此外，该配置项的属性应符合AUTOSAR CP 4.4标准中对PduR的规定。
      float PduRMainFunctionPeriod [0..1]: 0..65.535, multiplicity set at link in variant link-time+post-build / pre-compile in variant pre-compile, set at link in variant link-time+post-build / pre-compile in variant pre-compile, default-value=0.001  # Call cycle in seconds of PduRMainFunction. / 概述：PduRMainFunctionPeriod配置项指定了CAN状态管理主函数（PduRMainFunction）的调用周期，这个周期决定了PduR跨核路由时异步跨核传输的执行频率。 注意：该值必须与系统定时器和OS任务调度配置相匹配，以确保准确的时间行为；在配置时需要考虑到ECU的性能和网络的实时性要求。
    container PduRInterruptServiceRoutine [0..255]: multiplicity set at pre-compile, post-build-variant-multiplicity=true  # Contains the configuration parameters of the AUTOSAR PduR module's PduRMainFunction. / 概述：PduRInterruptServiceRoutine是一个配置项，用于IF类消息跨核路由的目的核触发功能 注意：在配置PduRInterruptServiceRoutine时，需要确保会关联到正确的中断上。
      reference PduROsIsrRef: post-build-variant-value=true, set at post-build in variant post-build / pre-compile in variant pre-compile, destination=OsIsr  # Destination PDU reference; reference to unique PDU identifier which shall be used by the PDU Router instead of the source PDU ID when calling the related function of the destination module.
package /AUTOSAR/EcucDestinationUriDefSets
  ecuc destination uri def set RteRipsUriDefSet
    ecuc destination uri def RteRipsInvocationHandler
      destination-uri-policy destination-uri-nesting-contract=TARGET-CONTAINER:
        container RteRipsInvocationHandlerFnc [0..*]  # This container describes an invocation handler function implemented by an RTE Implementation Plug-In to handle the invocation of server runnables and triggered runnables via a transformer. Tags: atp.Status=draft
          function name RteRipsInvocationHandlerFncSymbol  # C-Symbol of the Rte_Rips_FillFlushRoutine function. Tags: atp.Status=draft
    ecuc destination uri def RteRipsPlugin
      destination-uri-policy destination-uri-nesting-contract=TARGET-CONTAINER:
        container RteRipsPluginProps  # This container defines the identity of the Rte Implementation Plug-in and provides the RTE relevant parameters of the Rte Implementation Plug-in. Tags: atp.Status=draft | The shortName of the container defines the name of the Rte Implementation Plug-in used for the API infixes.
          boolean RtePluginSupportsIReadIWrite: default-value=false  # Denotes if or if not the plug-in supports the Rte_Rips_IRead/IWrite macros for primitive data. Tags: atp.Status=draft
          enumeration RteRipsGlobalCopyInstantiationPolicy: {RTE_RIPS_INSTANTIATION_BY_PLUGIN, RTE_RIPS_INSTANTIATION_BY_RTE}, default-value=RTE_RIPS_INSTANTIATION_BY_RTE  # Globally enables or disables the support for Rte Implementation Plug-Ins (RIPS) Tags: atp.Status=draft
    ecuc destination uri def RteRipsPluginFillFlushRoutine
      destination-uri-policy destination-uri-nesting-contract=TARGET-CONTAINER:
        container RteRipsPluginFillFlushRoutineFnc [0..*]  # This container describes a Fill-Flush Routine function implemented by a RTE Implementation Plug-In to handle the buffering for implicit communication. Tags: atp.Status=draft
          enumeration RteRipsModeDisablingHandling: {RTE_RIPS_CONSIDER_MODE_DISABLINGS, RTE_RIPS_IGNORE_MODE_DISABLINGS}  # This parameter configures whether mode disabling dependencies are considered for the invocation of Rte_Rips_FillFlushRoutines. Tags: atp.Status=draft
          enumeration RteRipsOsSchedulePoint [0..1]: {NONE, UNCONDITIONAL}  # Introduce a schedule point by explicitly calling Os Schedule service after the execution of the Rte_Rips_FillFlushRoutine. Tags: atp.Status=draft
          function name RteRipsPluginFillFlushRoutineFncSymbol  # C-Symbol of the Rte_Rips_FillFlushRoutine function. Tags: atp.Status=draft
package /AUTOSAR/LifeCycleInfoSets
  life cycle info set AUTOSARParameterDefinition
    life-cycle-infos:
      lc-object=AdcGroupEcucPartitionRef, lc-state=draft
      lc-object=AdcEcucPartitionRef, lc-state=draft
      lc-object=AdcKernelEcucPartitionRef, lc-state=draft
      lc-object=ArtiConstant, lc-state=draft
      lc-object=ArtiConstantString, lc-state=draft
      lc-object=ArtiExpression, lc-state=draft
      lc-object=ArtiExpressionString, lc-state=draft
      lc-object=ArtiHook, lc-state=draft
      lc-object=ArtiHookClass, lc-state=draft
      lc-object=ArtiHookEventName, lc-state=draft
      lc-object=ArtiHookInstance, lc-state=draft
      lc-object=ArtiHookEventParameterTypeRef, lc-state=draft
      lc-object=ArtiHookInstanceParameterTypeRef, lc-state=draft
      lc-object=ArtiObjectClassParameter, lc-state=draft
      lc-object=ArtiParameterTypeMapRef, lc-state=draft
      lc-object=ArtiObjectInstanceParameter, lc-state=draft
      lc-object=ArtiConstantRef, lc-state=draft
      lc-object=ArtiExpressionRef, lc-state=draft
      lc-object=ArtiHookRef, lc-state=draft
      lc-object=ArtiParameterTypeMap, lc-state=draft
      lc-object=ArtiParameterTypeMapPair, lc-state=draft
      lc-object=ArtiParameterTypeMapPairInput, lc-state=draft
      lc-object=ArtiParameterTypeMapPairOutput, lc-state=draft
      lc-object=ArtiGenericComponentClass, lc-state=draft
      lc-object=ArtiGenericComponentClassName, lc-state=draft
      lc-object=ArtiGenericComponentClassParameter, lc-state=draft
      lc-object=ArtiGenericComponentClassParameterName, lc-state=draft
      lc-object=ArtiParameterTypeMapRef, lc-state=draft
      lc-object=ArtiGenericComponentInstance, lc-state=draft
      lc-object=ArtiGenericComponentInstanceName, lc-state=draft
      lc-object=ArtiGenericComponentClassRef, lc-state=draft
      lc-object=ArtiGenericComponentInstanceParameter, lc-state=draft
      lc-object=ArtiConstantRef, lc-state=draft
      lc-object=ArtiExpressionRef, lc-state=draft
      lc-object=ArtiGenericComponentClassParameterRef, lc-state=draft
      lc-object=ArtiHookRef, lc-state=draft
      lc-object=ArtiHwCoreClass, lc-state=draft
      lc-object=ArtiCurrentApplicationClassRef, lc-state=draft
      lc-object=ArtiCurrentTaskClassRef, lc-state=draft
      lc-object=ArtiLastErrorClassRef, lc-state=draft
      lc-object=ArtiHwCoreInstance, lc-state=draft
      lc-object=ArtiCurrentApplicationInstanceRef, lc-state=draft
      lc-object=ArtiCurrentTaskInstanceRef, lc-state=draft
      lc-object=ArtiEcucCoreRef, lc-state=draft
      lc-object=ArtiLastErrorInstanceRef, lc-state=draft
      lc-object=ArtiOsClass, lc-state=draft
      lc-object=ArtiOsAppModeClassRef, lc-state=draft
      lc-object=ArtiOsInstance, lc-state=draft
      lc-object=ArtiOsAppModeEcucRef, lc-state=draft
      lc-object=ArtiOsAppModeInstanceRef, lc-state=draft
      lc-object=ArtiOsEcucRef, lc-state=draft
      lc-object=ArtiOsTaskHookRef, lc-state=draft
      lc-object=ArtiOsTaskClass, lc-state=draft
      lc-object=ArtiOsTaskInstance, lc-state=draft
      lc-object=ArtiGenericComponentInstanceRef, lc-state=draft
      lc-object=ArtiOsTaskEcucRef, lc-state=draft
      lc-object=CanControllerEcucPartitionRef, lc-state=draft
      lc-object=CanTTControllerEcucPartitionRef, lc-state=draft
      lc-object=CanEcucPartitionRef, lc-state=draft
      lc-object=CanTSynGlobalTimeSecureTmacLength, lc-state=draft
      lc-object=CanTSynTxTmacCalculated, lc-state=draft
      lc-object=CanTSynGlobalTimeMinMsgGap, lc-state=draft
      lc-object=CanTSynRxTmacValidated, lc-state=draft
      lc-object=CanTrcvChannelEcucPartitionRef, lc-state=draft
      lc-object=CanTrcvEcucPartitionRef, lc-state=draft
      lc-object=CorTstBackgroundEcucPartitionRef, lc-state=draft
      lc-object=CorTstForegroundEcucPartitionRef, lc-state=draft
      lc-object=CorTstEcucPartitionRef, lc-state=draft
      lc-object=CryptoDriverObjectEcucPartitionRef, lc-state=draft
      lc-object=CryptoEcucPartitionRef, lc-state=draft
      lc-object=DemFreezeFrameRecordTrigger, lc-state=draft
      lc-object=DioPortEcucPartitionRef, lc-state=draft
      lc-object=DioChannelEcucPartitionRef, lc-state=draft
      lc-object=DioChannelGroupEcucPartitionRef, lc-state=draft
      lc-object=DioEcucPartitionRef, lc-state=draft
      lc-object=EepEcucPartitionRef, lc-state=draft
      lc-object=EthCtrlEcucPartitionRef, lc-state=draft
      lc-object=EthEcucPartitionRef, lc-state=draft
      lc-object=EthSwtConfigEcucPartitionRef, lc-state=draft
      lc-object=EthSwtEcucPartitionRef, lc-state=draft
      lc-object=EthTSynGlobalTimeSecureTmacLength, lc-state=draft
      lc-object=EthTSynGlobalTimeMinMsgGap, lc-state=draft
      lc-object=EthTSynTxTmacCalculated, lc-state=draft
      lc-object=EthTSynRxTmacValidated, lc-state=draft
      lc-object=EthTrcvConfigEcucPartitionRef, lc-state=draft
      lc-object=EthTrcvEcucPartitionRef, lc-state=draft
      lc-object=FlsEcucPartitionRef, lc-state=draft
      lc-object=FlsTstEcucPartitionRef, lc-state=draft
      lc-object=FrEcucPartitionRef, lc-state=draft
      lc-object=FrCtrlEcucPartitionRef, lc-state=draft
      lc-object=FrTSynGlobalTimeSecureTmacLength, lc-state=draft
      lc-object=FrTSynUseExtendedMsgFormat, lc-state=draft
      lc-object=FrTSynTxTmacCalculated, lc-state=draft
      lc-object=FrTSynGlobalTimeMinMsgGap, lc-state=draft
      lc-object=FrTSynGlobalTimeTmacTimeout, lc-state=draft
      lc-object=FrTSynRxTmacValidated, lc-state=draft
      lc-object=FrTrcvChannelEcucPartitionRef, lc-state=draft
      lc-object=FrTrcvEcucPartitionRef, lc-state=draft
      lc-object=GptChannelEcucPartitionRef, lc-state=draft
      lc-object=GptEcucPartitionRef, lc-state=draft
      lc-object=GptKernelEcucPartitionRef, lc-state=draft
      lc-object=IcuChannelEcucPartitionRef, lc-state=draft
      lc-object=IcuEcucPartitionRef, lc-state=draft
      lc-object=IcuKernelEcucPartitionRef, lc-state=draft
      lc-object=IpduMContainedPduOffset, lc-state=draft
      lc-object=IpduMPduUpdateBitPosition, lc-state=draft
      lc-object=IpduMContainedPduOffset, lc-state=draft
      lc-object=IpduMPduUpdateBitPosition, lc-state=draft
      lc-object=IPDUM_HEADERTYPE_NONE, lc-state=draft
      lc-object=IPDUM_HEADERTYPE_NONE, lc-state=draft
      lc-object=IpduMUnusedAreasDefault, lc-state=draft
      lc-object=LinEcucPartitionRef, lc-state=draft
      lc-object=LinChannelEcucPartitionRef, lc-state=draft
      lc-object=LinTrcvChannelEcucPartitionRef, lc-state=draft
      lc-object=LinTrcvEcucPartitionRef, lc-state=draft
      lc-object=McuEcucPartitionRef, lc-state=draft
      lc-object=OcuChannelEcucPartitionRef, lc-state=draft
      lc-object=OcuEcucPartitionRef, lc-state=draft
      lc-object=OcuKernelEcucPartitionRef, lc-state=draft
      lc-object=PortPinEcucPartitionRef, lc-state=draft
      lc-object=PortEcucPartitionRef, lc-state=draft
      lc-object=PwmChannelEcucPartitionRef, lc-state=draft
      lc-object=PwmEcucPartitionRef, lc-state=draft
      lc-object=PwmKernelEcucPartitionRef, lc-state=draft
      lc-object=RamTstEcucPartitionRef, lc-state=draft
      lc-object=RamTstBlockParamsEcucPartitionRef, lc-state=draft
      lc-object=RteRipsFillRoutineRef, lc-state=draft
      lc-object=RteRipsFlushRoutineRef, lc-state=draft
      lc-object=RteBswExclusiveAreaResponsibleRipsPluginRef, lc-state=draft
      lc-object=RteModeMachineInstanceResponsibleRipsPluginRef, lc-state=draft
      lc-object=RteDSMQResponsibleRipsPluginRef, lc-state=draft
      lc-object=RteRips, lc-state=draft
      lc-object=RteRipsSupport, lc-state=draft
      lc-object=RteRipsPluginConfigurationRef, lc-state=draft
      lc-object=RteRipsFillRoutineRef, lc-state=draft
      lc-object=RteRipsFlushRoutineRef, lc-state=draft
      lc-object=RteRipsInvocationHandlerRef, lc-state=draft
      lc-object=RteExclusiveAreaResponsibleRipsPluginRef, lc-state=draft
      lc-object=RteModeMachineInstanceResponsibleRipsPluginRef, lc-state=draft
      lc-object=SoAdSocketTcpTlsConnectionRef, lc-state=draft
      lc-object=SpiDeviceEcucPartitionRef, lc-state=draft
      lc-object=SpiEcucPartitionRef, lc-state=draft
      lc-object=SpiKernelEcucPartitionRef, lc-state=draft
      lc-object=TcpIpTlsConfig, lc-state=draft
      lc-object=TcpIpTlsMaxConnections, lc-state=draft
      lc-object=TcpIpTlsCsmRandomGenerateJobRef, lc-state=draft
      lc-object=TcpIpTlsCiphersuites, lc-state=draft
      lc-object=TcpIpTlsCertificateIdentity, lc-state=draft
      lc-object=TcpIpTlsServerNameIdentification, lc-state=draft
      lc-object=TcpIpTlsCiphersuiteDefinition, lc-state=draft
      lc-object=TcpIpTlsCiphersuiteId, lc-state=draft
      lc-object=TcpIpTlsCiphersuiteName, lc-state=draft
      lc-object=TcpIpTlsCiphersuitePriority, lc-state=draft
      lc-object=TcpIpTlsUseAEADCipher, lc-state=draft
      lc-object=TcpIpTlsUsePresharedKeys, lc-state=draft
      lc-object=TcpIpTlsUseSecurityExtensionForceMacThenHash, lc-state=draft
      lc-object=TcpIpTlsVersion, lc-state=draft
      lc-object=TcpIpTlsCiphersuiteWorker, lc-state=draft
      lc-object=TcpIpTlsCipherAEADCipherKeyLength, lc-state=draft
      lc-object=TcpIpTlsCipherEncryptKeyLength, lc-state=draft
      lc-object=TcpIpTlsCipherMacKeyLength, lc-state=draft
      lc-object=TcpIpTlsCipherCsmDecryptJobRef, lc-state=draft
      lc-object=TcpIpTlsCipherCsmDecryptKeyRef, lc-state=draft
      lc-object=TcpIpTlsCipherCsmEncryptJobRef, lc-state=draft
      lc-object=TcpIpTlsCipherCsmEncryptKeyRef, lc-state=draft
      lc-object=TcpIpTlsCipherCsmMacGenerateJobRef, lc-state=draft
      lc-object=TcpIpTlsCipherCsmMacGenerateKeyRef, lc-state=draft
      lc-object=TcpIpTlsCipherCsmMacVerifyJobRef, lc-state=draft
      lc-object=TcpIpTlsCipherCsmMacVerifyKeyRef, lc-state=draft
      lc-object=TcpIpTlsCiphersuiteDefinitionRef, lc-state=draft
      lc-object=TcpIpTlsConnectionHandshakeRef, lc-state=draft
      lc-object=TcpIpTlsHandshake, lc-state=draft
      lc-object=TcpIpTlsCsmPRFSupportType, lc-state=draft
      lc-object=TcpIpTlsCsmHashVerifyJobRef, lc-state=draft
      lc-object=TcpIpTlsCsmKeyExchangeCalcPubValJobRef, lc-state=draft
      lc-object=TcpIpTlsCsmKeyExchangeCalcSecretJobRef, lc-state=draft
      lc-object=TcpIpTlsCsmKeyExchangeDecryptJobRef, lc-state=draft
      lc-object=TcpIpTlsCsmKeyExchangeDecryptKeyRef, lc-state=draft
      lc-object=TcpIpTlsCsmKeyExchangeEncryptJobRef, lc-state=draft
      lc-object=TcpIpTlsCsmKeyExchangeEncryptKeyRef, lc-state=draft
      lc-object=TcpIpTlsCsmKeyExchangeKeyRef, lc-state=draft
      lc-object=TcpIpTlsCsmKeyExchangeSignatureGenerateJobRef, lc-state=draft
      lc-object=TcpIpTlsCsmKeyExchangeSignatureGenerateKeyRef, lc-state=draft
      lc-object=TcpIpTlsCsmKeyExchangeSignatureVerifyJobRef, lc-state=draft
      lc-object=TcpIpTlsCsmKeyExchangeSignatureVerifyKeyRef, lc-state=draft
      lc-object=TcpIpTlsCsmMasterSecretKeyRef, lc-state=draft
      lc-object=TcpIpTlsCsmPrfMacJobRef, lc-state=draft
      lc-object=TcpIpTlsCsmPrfMacKeyRef, lc-state=draft
      lc-object=TcpIpTlsPskIdentity, lc-state=draft
      lc-object=TcpIpTlsPresharedKeyIdentity, lc-state=draft
      lc-object=TcpIpTlsPresharedKeyIdentityHint, lc-state=draft
      lc-object=TcpIpTlsPskGetClientKeyIdentityFunc, lc-state=draft
      lc-object=TcpIpTlsPskGetKeyIdentyHintFunc, lc-state=draft
      lc-object=TcpIpTlsPskGetServerKeyIdentityFunc, lc-state=draft
      lc-object=TcpIpTlsPresharedKeyCsmKeyRef, lc-state=draft
      lc-object=TcpIpTlsConnection, lc-state=draft
      lc-object=TcpIpTlsConnectionGetTimeFunc, lc-state=draft
      lc-object=TcpIpTlsConnectionId, lc-state=draft
      lc-object=TcpIpTlsConnectionType, lc-state=draft
      lc-object=TcpIpTlsMaxFragmentLength, lc-state=draft
      lc-object=TcpIpTlsPortAssignment, lc-state=draft
      lc-object=TcpIpTlsUseClientAuthenticationRequest, lc-state=draft
      lc-object=TcpIpTlsUseSecurityExtensionRecordSizeLimit, lc-state=draft
      lc-object=TcpIpTlsCertificateIdentityRef, lc-state=draft
      lc-object=TcpIpTlsConnectionCiphersuiteWorkerRef, lc-state=draft
      lc-object=TcpIpTlsConnectionGroupRef, lc-state=draft
      lc-object=TcpIpTlsConnectionPskIdentityRef, lc-state=draft
      lc-object=TcpIpTlsIpAddressAssignment, lc-state=draft
      lc-object=TcpIpTlsConnectionGroup, lc-state=draft
      lc-object=WEthCtrlEcucPartitionRef, lc-state=draft
      lc-object=WEthEcucPartitionRef, lc-state=draft
      lc-object=WEthTrcvConfigEcucPartitionRef, lc-state=draft
      lc-object=WEthTrcvEcucPartitionRef, lc-state=draft
      lc-object=WdgEcucPartitionRef, lc-state=draft
