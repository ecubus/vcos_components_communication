AUTOSAR XML (schema 00046)
package /ActiveEcuC
  module config CanIf: implementation-config-variant=VARIANT-PRE-COMPILE, module-description=CanIf_Impl
    CanIfDispatchCfg:
      CanIfDispatchUserCtrlBusOffName = cansm_controller_bus_off
      CanIfDispatchUserCtrlBusOffUL = CAN_SM
      CanIfDispatchUserCtrlModeIndicationName = cansm_controller_mode_indication
      CanIfDispatchUserCtrlModeIndicationUL = CAN_SM
      CanIfDispatchUserTrcvModeIndicationName = cansm_transceiver_mode_indication
      CanIfDispatchUserTrcvModeIndicationUL = CAN_SM
      CanIfDispatchUserCheckTrcvWakeFlagIndicationName = cansm_check_transceiver_wake_flag_indication
      CanIfDispatchUserCheckTrcvWakeFlagIndicationUL = CAN_SM
      CanIfDispatchUserClearTrcvWufFlagIndicationName = cansm_clear_trcv_wuf_flag_indication
      CanIfDispatchUserClearTrcvWufFlagIndicationUL = CAN_SM
      CanIfDispatchUserConfirmPnAvailabilityName = cansm_confirm_pn_availability
      CanIfDispatchUserConfirmPnAvailabilityUL = CAN_SM
      CanIfDispatchUserValidateWakeupEventUL = (unset)
      CanIfDispatchUserValidateWakeupEventName = (unset)
    CanIfInitCfg: CanIfMaxBufferSize=(unset), CanIfMaxRxPduCfg=(unset), CanIfMaxTxPduCfg=(unset), CanIfInitCfgSet=(unset)
      CanIfInitHohCfg
    CanIfPrivateCfg: CanIfSupportTTCAN=false, CanIfFixedBuffer=false, CanIfPrivateDataLengthCheck=true, CanIfPrivateSoftwareFilterType=LINEAR
    CanIfPublicCfg:
      CanIfPublicPnSupport = false
      CanIfDevErrorDetect = false
      CanIfPublicMultipleDrvSupport = false
      CanIfPublicReadRxPduDataApi = false
      CanIfPublicReadRxPduNotifyStatusApi = false
      CanIfPublicReadTxPduNotifyStatusApi = false
      CanIfPublicSetDynamicTxIdApi = false
      CanIfPublicTxBuffering = true
      CanIfPublicTxConfirmPollingSupport = true
      CanIfPublicWakeupCheckValidSupport = false
      CanIfBusMirroringSupport = false
      CanIfSetBaudrateApi = false
      CanIfMetaDataSupport = false
      CanIfPublicIcomSupport = false
      CanIfPublicWakeupCheckValidByNM = false
      CanIfTriggerTransmitSupport = true
      CanIfTxOfflineActiveSupport = false
      CanIfVersionInfoApi = false
      CanIfWakeupSupport = true
      CanIfUserTxCalloutSupport = false
      CanIfUserTxConfirmationCalloutSupport = false
      CanIfUserRxIndicationCalloutSupport = false
      CanIfPublicDebugSupport = false
      CanIfMapMcalApiPrefix = Can_17_McmCan
      CanIfPublicHandleTypeEnum = UINT8
      CanIfPublicCddHeaderFile = 
      CanIfPublicUserCbkHeaderFile = (unset)
    CanIfTrcvDrvCfg
      CanIfTrcvCfg:
        CanIfTrcvId = 0
        CanIfTrcvWakeupSupport = true
        CanTrcvType = CanTrcv1145
        CanIfTrcvCanTrcv = CanTrcv1145_ECU_DEMO_CAN1
        CanTrcvWakeupSourceRef = 
        CanIfTrcvChnlToCanIfCtrlChnlRef = (unset)
    CanIfCtrlDrvCfg: CanIfCtrlDrvInitHohConfigRef=(unset), CanIfCtrlDrvNameRef=(unset)
